OUTPUT_ARCH (mips)
       
       
       
       
       
       
       
       
       
       
       
       
       
       
       
       
SECTIONS
{
   __romPos = 0;
   _bootSegmentStart = ADDR(.boot); _bootSegmentRomStart = __romPos; .boot 0x04000000 : AT(__romPos)
   {
      KEEP(build/us_n64/asm/rom_header.o(.text*));
      KEEP(build/us_n64/asm/ipl3.o(.text*));
   }
   _bootSegmentEnd = ADDR(.boot) + SIZEOF(.boot); _bootSegmentRomEnd = __romPos + SIZEOF(.boot); __romPos += SIZEOF(.boot);
   . = (0x80000000 + 0x400);
   _buffersSegmentBssStart = ADDR(.buffers.noload); .buffers.noload (NOLOAD) :
   {
      build/us_n64/src/buffers/buffers.o(.bss*);
      build/us_n64/src/audio/globals_start.o(.bss*);
      build/us_n64/src/audio/synthesis.o(.bss*);
      build/us_n64/src/audio/heap.o(.bss*);
      build/us_n64/src/audio/load.o(.bss*);
      build/us_n64/src/audio/data.o(.bss*);
      build/us_n64/src/audio*.o(.bss*);
      . = ALIGN(0x10);
   }
   _buffersSegmentBssEnd = ADDR(.buffers.noload) + SIZEOF(.buffers.noload); _buffersSegmentBssSize = SIZEOF(.buffers.noload);
   . = _buffersSegmentBssEnd;
   _mainSegmentStart = ADDR(.main); _mainSegmentRomStart = __romPos; .main . : AT(__romPos) SUBALIGN(16)
   {
      KEEP(build/us_n64/asm/entry.o(.text*));
      KEEP(build/us_n64/asm/n64_assert.o(.text*));
      KEEP(build/us_n64/asm/setgp.o(.text*));
      KEEP(build/us_n64/asm/vc_bin.o(.text*));
      KEEP(build/us_n64/asm/emux.o(.text*));
      KEEP(build/us_n64/asm/pj64_get_count_factor_asm.o(.text*));
      KEEP(build/us_n64/asm/round.o(.text*));
      KEEP(build/us_n64/asm/fcr31.o(.text*));
      build/us_n64/src/boot*.o(.text*);
      build/us_n64/src/hvqm*.o(.text*);
      build/us_n64/src/usb*.o(.text*);
      build/us_n64/src/audio*.o(.text*);
      *libultra_rom.a:*.o(.text*);
      *libnustd.a:*.o(.text*);
      *libgcc.a:*.o(.text*);
      *libz.a:*.o(.text*);
      */libhvqm2.a:*.o(.text*);
      lib/rspboot.o(.text*);
      lib/PR/f3dex2/fifo/gspF3DEX2.fifo.o(.text);
      build/us_n64/lib/gspF3DZEX2.NoN_PosLight.fifo.o(.text);
      build/us_n64/lib/aspMain.o(.text*);
      lib/PR/audio/n_aspMain.o(.text*);
      lib/PR/hvqm/hvqm2sp1.o(.text*);
      _mainSegmentTextEnd = .;
      build/us_n64/asm/n64_assert.o(.data*);
      build/us_n64/src/boot*.o(.data*);
      build/us_n64/src/audio*.o(.data*);
      *libultra_rom.a:*.o(.data*);
      */libhvqm2.a:*.o(.data*);
      *libz.a:*.o(.data*);
      lib/PR/f3dex2/fifo/gspF3DEX2.fifo.o(.data);
      build/us_n64/lib/gspF3DZEX2.NoN_PosLight.fifo.o(.data);
      build/us_n64/lib/aspMain.o(.data*);
      lib/PR/audio/n_aspMain.o(.data*);
      lib/PR/hvqm/hvqm2sp1.o(.data*);
      build/us_n64/src/boot*.o(.rodata*);
      build/us_n64/src/usb*.o(.rodata*);
      build/us_n64/src/audio*.o(.rodata*);
      *libultra_rom.a:*.o(.rodata*);
      *libgcc.a:*.o(.rodata*);
      *libz.a:*.o(.rodata*);
      lib/PR/hvqm/hvqm2sp1.o(.rodata*);
   }
   _mainSegmentEnd = ADDR(.main) + SIZEOF(.main); _mainSegmentRomEnd = __romPos + SIZEOF(.main); __romPos += SIZEOF(.main);
   _mainSegmentBssStart = ADDR(.main.noload); .main.noload (NOLOAD) :
   {
      build/us_n64/src/boot*.o(.bss*);
      build/us_n64/src/hvqm*.o(.bss*);
      build/us_n64/src/usb*.o(.bss*);
      build/us_n64/src/audio*.o(.bss*);
      *libultra_rom.a:*.o(COMMON);
      *libultra_rom.a:*.o(.scommon);
      *libultra_rom.a:*.o(.bss*);
      */libhvqm2.a:*.o(.bss*);
      *libz.a:*.o(.bss*);
      . = ALIGN(0x8);
   }
   _mainSegmentBssEnd = ADDR(.main.noload) + SIZEOF(.main.noload); _mainSegmentBssSize = SIZEOF(.main.noload);
   . = _mainSegmentBssEnd;
   _engineSegmentStart = ADDR(.engine); _engineSegmentRomStart = __romPos; .engine . : AT(__romPos)
   {
      build/us_n64/src/game*.o(.text*);
      build/us_n64/src/game/behavior_actions.o(.text*);
      build/us_n64/src/game/obj_behaviors_2.o(.text*);
      build/us_n64/src/game/obj_behaviors.o(.text*);
      build/us_n64/src/game/object_helpers.o(.text*);
      build/us_n64/src/game/rendering_graph_node.o(.text*);
      build/us_n64/src/engine/math_util.o(.text*);
      build/us_n64/src/engine/surface_collision.o(.text*);
      build/us_n64/src/engine/surface_load.o(.text*);
      build/us_n64/src/engine/graph_node.o(.text*);
      build/us_n64/src/engine*.o(.text*);
      build/us_n64/src/hacktice*.o(.text*);
      _engineSegmentTextEnd = .;
      build/us_n64/src/game*.o(.data*);
      build/us_n64/src/engine*.o(.data*);
      build/us_n64/src/usb*.o(.data*);
      build/us_n64/src/hacktice*.o(.data*);
      build/us_n64/src/game*.o(.rodata*);
      build/us_n64/src/engine*.o(.rodata*);
      build/us_n64/src/usb*.o(.rodata*);
      build/us_n64/src/hacktice*.o(.rodata*);
      . = ALIGN(0x10);
   }
   _engineSegmentEnd = ADDR(.engine) + SIZEOF(.engine); _engineSegmentRomEnd = __romPos + SIZEOF(.engine); __romPos += SIZEOF(.engine);
   _engineSegmentBssStart = ADDR(.engine.noload); .engine.noload (NOLOAD) :
   {
      build/us_n64/src/game/crash_screen.o(.bss*);
      build/us_n64/src/game/game_init.o(.bss*);
      build/us_n64/src/game/sound_init.o(.bss*);
      _hackticeStateDataStart0 = .;
      build/us_n64/src/game*.o(.bss*);
      _hackticeStateDataEnd0 = .;
      build/us_n64/src/engine*.o(.bss*);
      build/us_n64/src/hacktice*.o(.bss*);
      . = ALIGN(0x40);
   }
   _engineSegmentBssEnd = ADDR(.engine.noload) + SIZEOF(.engine.noload); _engineSegmentBssSize = SIZEOF(.engine.noload);
   _gp = . + 0x8000;
   _sdataSegmentStart = ADDR(.sdata); _sdataSegmentRomStart = __romPos; .sdata . : AT(__romPos)
   {
      build/us_n64/src/game*.o(.sdata*);
      build/us_n64/src/audio*.o(.sdata*);
      build/us_n64/src/engine*.o(.sdata*);
      build/us_n64/src/usb*.o(.sdata*);
      build/us_n64/src/menu*.o(.sdata*);
      build/us_n64/src/hacktice*.o(.sdata*);
      *libz.a:*.o(.sdata*);
   }
   _sdataSegmentEnd = ADDR(.sdata) + SIZEOF(.sdata); _sdataSegmentRomEnd = __romPos + SIZEOF(.sdata); __romPos += SIZEOF(.sdata);
   _sbssSegmentBssStart = ADDR(.sbss.noload); .sbss.noload (NOLOAD) :
   {
      build/us_n64/src/game/crash_screen.o(.sdata*);
      build/us_n64/src/game/game_init.o(.sdata*);
      build/us_n64/src/game/sound_init.o(.sdata*);
      _hackticeStateDataStart1 = .;
      build/us_n64/src/game*.o(.sbss*);
      _hackticeStateDataEnd1 = .;
      build/us_n64/src/game*.o(.sbss*);
      build/us_n64/src/audio*.o(.sbss*);
      build/us_n64/src/engine*.o(.sbss*);
      build/us_n64/src/usb*.o(.sbss*);
      build/us_n64/src/menu*.o(.sbss*);
      build/us_n64/src/hacktice*.o(.sbss*);
      *libz.a:*.o(.sbss*);
      . = ALIGN(0x40);
   }
   _sbssSegmentBssEnd = ADDR(.sbss.noload) + SIZEOF(.sbss.noload); _sbssSegmentBssSize = SIZEOF(.sbss.noload);
   _poolStart = .;
   . = 0x80400000 - (0x3000 * 8);
   _gfxfifoSegmentBssStart = ADDR(.gfxfifo.noload); .gfxfifo.noload (NOLOAD) :
   {
      build/us_n64/src/buffers/gfx_output_buffer.o(.bss*);
   }
   _gfxfifoSegmentBssEnd = ADDR(.gfxfifo.noload) + SIZEOF(.gfxfifo.noload); _gfxfifoSegmentBssSize = SIZEOF(.gfxfifo.noload);
   . = 0x80400000;
   _zbufferSegmentBssStart = ADDR(.zbuffer.noload); .zbuffer.noload (NOLOAD) :
   {
      build/us_n64/src/buffers/zbuffer.o(.bss*);
   }
   _zbufferSegmentBssEnd = ADDR(.zbuffer.noload) + SIZEOF(.zbuffer.noload); _zbufferSegmentBssSize = SIZEOF(.zbuffer.noload);
   . = 0x80500000;
   _framebuffer0SegmentBssStart = ADDR(.framebuffer0.noload); .framebuffer0.noload (NOLOAD) :
   {
      build/us_n64/src/buffers/framebuffer0.o(.bss*);
   }
   _framebuffer0SegmentBssEnd = ADDR(.framebuffer0.noload) + SIZEOF(.framebuffer0.noload); _framebuffer0SegmentBssSize = SIZEOF(.framebuffer0.noload);
   . = 0x80600000;
   _framebuffer1SegmentBssStart = ADDR(.framebuffer1.noload); .framebuffer1.noload (NOLOAD) :
   {
      build/us_n64/src/buffers/framebuffer1.o(.bss*);
   }
   _framebuffer1SegmentBssEnd = ADDR(.framebuffer1.noload) + SIZEOF(.framebuffer1.noload); _framebuffer1SegmentBssSize = SIZEOF(.framebuffer1.noload);
   . = 0x80700000;
   _framebuffer2SegmentBssStart = ADDR(.framebuffer2.noload); .framebuffer2.noload (NOLOAD) :
   {
      build/us_n64/src/buffers/framebuffer2.o(.bss*);
   }
   _framebuffer2SegmentBssEnd = ADDR(.framebuffer2.noload) + SIZEOF(.framebuffer2.noload); _framebuffer2SegmentBssSize = SIZEOF(.framebuffer2.noload);
   __expansionRamStart = (0x80000000 + (0x00100000 * 4));
   _entrySegmentStart = ADDR(.entry); _entrySegmentRomStart = __romPos; .entry 0x10000000 : AT(__romPos)
   {
      build/us_n64/levels/entry.o(.data*);
   }
   _entrySegmentEnd = ADDR(.entry) + SIZEOF(.entry); _entrySegmentRomEnd = __romPos + SIZEOF(.entry); __romPos += SIZEOF(.entry);
   _segment2_yay0SegmentStart = ADDR(.segment2_yay0); _segment2_yay0SegmentRomStart = __romPos; .segment2_yay0 0x02000000 : AT(__romPos) { KEEP(build/us_n64/bin/segment2.szp.o(.data*)); KEEP(build/us_n64/bin/segment2.szp.o(.rodata*)); . = ALIGN(0x10); } _segment2_yay0SegmentEnd = ADDR(.segment2_yay0) + SIZEOF(.segment2_yay0); _segment2_yay0SegmentRomEnd = __romPos + SIZEOF(.segment2_yay0); __romPos += SIZEOF(.segment2_yay0); _segment2_mio0SegmentRomStart = _segment2_yay0SegmentRomStart; _segment2_mio0SegmentRomEnd = _segment2_yay0SegmentRomEnd;
   _group0_yay0SegmentStart = ADDR(.group0_yay0); _group0_yay0SegmentRomStart = __romPos; .group0_yay0 0x04000000 : AT(__romPos) { KEEP(build/us_n64/actors/group0.szp.o(.data*)); . = ALIGN(0x10); } _group0_yay0SegmentEnd = ADDR(.group0_yay0) + SIZEOF(.group0_yay0); _group0_yay0SegmentRomEnd = __romPos + SIZEOF(.group0_yay0); __romPos += SIZEOF(.group0_yay0); _group0_geoSegmentStart = ADDR(.group0_geo); _group0_geoSegmentRomStart = __romPos; .group0_geo 0x17000000 : AT(__romPos) { KEEP(build/us_n64/actors/group0_geo.o(.data*)); KEEP(build/us_n64/actors/group0_geo.o(.rodata*)); KEEP(build/us_n64/actors/group0_geo.o(.text*)); } _group0_geoSegmentEnd = ADDR(.group0_geo) + SIZEOF(.group0_geo); _group0_geoSegmentRomEnd = __romPos + SIZEOF(.group0_geo); __romPos += SIZEOF(.group0_geo); _group0_geoSegmentBssStart = ADDR(.group0_geo.noload); .group0_geo.noload (NOLOAD) : { KEEP(build/us_n64/actors/group0_geo.o(.bss*)); } _group0_geoSegmentBssEnd = ADDR(.group0_geo.noload) + SIZEOF(.group0_geo.noload); _group0_geoSegmentBssSize = SIZEOF(.group0_geo.noload); _group0_mio0SegmentRomStart = _group0_yay0SegmentRomStart; _group0_mio0SegmentRomEnd = _group0_yay0SegmentRomEnd;
   _group1_yay0SegmentStart = ADDR(.group1_yay0); _group1_yay0SegmentRomStart = __romPos; .group1_yay0 0x05000000 : AT(__romPos) { KEEP(build/us_n64/actors/group1.szp.o(.data*)); . = ALIGN(0x10); } _group1_yay0SegmentEnd = ADDR(.group1_yay0) + SIZEOF(.group1_yay0); _group1_yay0SegmentRomEnd = __romPos + SIZEOF(.group1_yay0); __romPos += SIZEOF(.group1_yay0); _group1_geoSegmentStart = ADDR(.group1_geo); _group1_geoSegmentRomStart = __romPos; .group1_geo 0x0C000000 : AT(__romPos) { KEEP(build/us_n64/actors/group1_geo.o(.data*)); KEEP(build/us_n64/actors/group1_geo.o(.rodata*)); KEEP(build/us_n64/actors/group1_geo.o(.text*)); } _group1_geoSegmentEnd = ADDR(.group1_geo) + SIZEOF(.group1_geo); _group1_geoSegmentRomEnd = __romPos + SIZEOF(.group1_geo); __romPos += SIZEOF(.group1_geo); _group1_geoSegmentBssStart = ADDR(.group1_geo.noload); .group1_geo.noload (NOLOAD) : { KEEP(build/us_n64/actors/group1_geo.o(.bss*)); } _group1_geoSegmentBssEnd = ADDR(.group1_geo.noload) + SIZEOF(.group1_geo.noload); _group1_geoSegmentBssSize = SIZEOF(.group1_geo.noload); _group1_mio0SegmentRomStart = _group1_yay0SegmentRomStart; _group1_mio0SegmentRomEnd = _group1_yay0SegmentRomEnd;
   _group2_yay0SegmentStart = ADDR(.group2_yay0); _group2_yay0SegmentRomStart = __romPos; .group2_yay0 0x05000000 : AT(__romPos) { KEEP(build/us_n64/actors/group2.szp.o(.data*)); . = ALIGN(0x10); } _group2_yay0SegmentEnd = ADDR(.group2_yay0) + SIZEOF(.group2_yay0); _group2_yay0SegmentRomEnd = __romPos + SIZEOF(.group2_yay0); __romPos += SIZEOF(.group2_yay0); _group2_geoSegmentStart = ADDR(.group2_geo); _group2_geoSegmentRomStart = __romPos; .group2_geo 0x0C000000 : AT(__romPos) { KEEP(build/us_n64/actors/group2_geo.o(.data*)); KEEP(build/us_n64/actors/group2_geo.o(.rodata*)); KEEP(build/us_n64/actors/group2_geo.o(.text*)); } _group2_geoSegmentEnd = ADDR(.group2_geo) + SIZEOF(.group2_geo); _group2_geoSegmentRomEnd = __romPos + SIZEOF(.group2_geo); __romPos += SIZEOF(.group2_geo); _group2_geoSegmentBssStart = ADDR(.group2_geo.noload); .group2_geo.noload (NOLOAD) : { KEEP(build/us_n64/actors/group2_geo.o(.bss*)); } _group2_geoSegmentBssEnd = ADDR(.group2_geo.noload) + SIZEOF(.group2_geo.noload); _group2_geoSegmentBssSize = SIZEOF(.group2_geo.noload); _group2_mio0SegmentRomStart = _group2_yay0SegmentRomStart; _group2_mio0SegmentRomEnd = _group2_yay0SegmentRomEnd;
   _group3_yay0SegmentStart = ADDR(.group3_yay0); _group3_yay0SegmentRomStart = __romPos; .group3_yay0 0x05000000 : AT(__romPos) { KEEP(build/us_n64/actors/group3.szp.o(.data*)); . = ALIGN(0x10); } _group3_yay0SegmentEnd = ADDR(.group3_yay0) + SIZEOF(.group3_yay0); _group3_yay0SegmentRomEnd = __romPos + SIZEOF(.group3_yay0); __romPos += SIZEOF(.group3_yay0); _group3_geoSegmentStart = ADDR(.group3_geo); _group3_geoSegmentRomStart = __romPos; .group3_geo 0x0C000000 : AT(__romPos) { KEEP(build/us_n64/actors/group3_geo.o(.data*)); KEEP(build/us_n64/actors/group3_geo.o(.rodata*)); KEEP(build/us_n64/actors/group3_geo.o(.text*)); } _group3_geoSegmentEnd = ADDR(.group3_geo) + SIZEOF(.group3_geo); _group3_geoSegmentRomEnd = __romPos + SIZEOF(.group3_geo); __romPos += SIZEOF(.group3_geo); _group3_geoSegmentBssStart = ADDR(.group3_geo.noload); .group3_geo.noload (NOLOAD) : { KEEP(build/us_n64/actors/group3_geo.o(.bss*)); } _group3_geoSegmentBssEnd = ADDR(.group3_geo.noload) + SIZEOF(.group3_geo.noload); _group3_geoSegmentBssSize = SIZEOF(.group3_geo.noload); _group3_mio0SegmentRomStart = _group3_yay0SegmentRomStart; _group3_mio0SegmentRomEnd = _group3_yay0SegmentRomEnd;
   _group4_yay0SegmentStart = ADDR(.group4_yay0); _group4_yay0SegmentRomStart = __romPos; .group4_yay0 0x05000000 : AT(__romPos) { KEEP(build/us_n64/actors/group4.szp.o(.data*)); . = ALIGN(0x10); } _group4_yay0SegmentEnd = ADDR(.group4_yay0) + SIZEOF(.group4_yay0); _group4_yay0SegmentRomEnd = __romPos + SIZEOF(.group4_yay0); __romPos += SIZEOF(.group4_yay0); _group4_geoSegmentStart = ADDR(.group4_geo); _group4_geoSegmentRomStart = __romPos; .group4_geo 0x0C000000 : AT(__romPos) { KEEP(build/us_n64/actors/group4_geo.o(.data*)); KEEP(build/us_n64/actors/group4_geo.o(.rodata*)); KEEP(build/us_n64/actors/group4_geo.o(.text*)); } _group4_geoSegmentEnd = ADDR(.group4_geo) + SIZEOF(.group4_geo); _group4_geoSegmentRomEnd = __romPos + SIZEOF(.group4_geo); __romPos += SIZEOF(.group4_geo); _group4_geoSegmentBssStart = ADDR(.group4_geo.noload); .group4_geo.noload (NOLOAD) : { KEEP(build/us_n64/actors/group4_geo.o(.bss*)); } _group4_geoSegmentBssEnd = ADDR(.group4_geo.noload) + SIZEOF(.group4_geo.noload); _group4_geoSegmentBssSize = SIZEOF(.group4_geo.noload); _group4_mio0SegmentRomStart = _group4_yay0SegmentRomStart; _group4_mio0SegmentRomEnd = _group4_yay0SegmentRomEnd;
   _group5_yay0SegmentStart = ADDR(.group5_yay0); _group5_yay0SegmentRomStart = __romPos; .group5_yay0 0x05000000 : AT(__romPos) { KEEP(build/us_n64/actors/group5.szp.o(.data*)); . = ALIGN(0x10); } _group5_yay0SegmentEnd = ADDR(.group5_yay0) + SIZEOF(.group5_yay0); _group5_yay0SegmentRomEnd = __romPos + SIZEOF(.group5_yay0); __romPos += SIZEOF(.group5_yay0); _group5_geoSegmentStart = ADDR(.group5_geo); _group5_geoSegmentRomStart = __romPos; .group5_geo 0x0C000000 : AT(__romPos) { KEEP(build/us_n64/actors/group5_geo.o(.data*)); KEEP(build/us_n64/actors/group5_geo.o(.rodata*)); KEEP(build/us_n64/actors/group5_geo.o(.text*)); } _group5_geoSegmentEnd = ADDR(.group5_geo) + SIZEOF(.group5_geo); _group5_geoSegmentRomEnd = __romPos + SIZEOF(.group5_geo); __romPos += SIZEOF(.group5_geo); _group5_geoSegmentBssStart = ADDR(.group5_geo.noload); .group5_geo.noload (NOLOAD) : { KEEP(build/us_n64/actors/group5_geo.o(.bss*)); } _group5_geoSegmentBssEnd = ADDR(.group5_geo.noload) + SIZEOF(.group5_geo.noload); _group5_geoSegmentBssSize = SIZEOF(.group5_geo.noload); _group5_mio0SegmentRomStart = _group5_yay0SegmentRomStart; _group5_mio0SegmentRomEnd = _group5_yay0SegmentRomEnd;
   _group6_yay0SegmentStart = ADDR(.group6_yay0); _group6_yay0SegmentRomStart = __romPos; .group6_yay0 0x05000000 : AT(__romPos) { KEEP(build/us_n64/actors/group6.szp.o(.data*)); . = ALIGN(0x10); } _group6_yay0SegmentEnd = ADDR(.group6_yay0) + SIZEOF(.group6_yay0); _group6_yay0SegmentRomEnd = __romPos + SIZEOF(.group6_yay0); __romPos += SIZEOF(.group6_yay0); _group6_geoSegmentStart = ADDR(.group6_geo); _group6_geoSegmentRomStart = __romPos; .group6_geo 0x0C000000 : AT(__romPos) { KEEP(build/us_n64/actors/group6_geo.o(.data*)); KEEP(build/us_n64/actors/group6_geo.o(.rodata*)); KEEP(build/us_n64/actors/group6_geo.o(.text*)); } _group6_geoSegmentEnd = ADDR(.group6_geo) + SIZEOF(.group6_geo); _group6_geoSegmentRomEnd = __romPos + SIZEOF(.group6_geo); __romPos += SIZEOF(.group6_geo); _group6_geoSegmentBssStart = ADDR(.group6_geo.noload); .group6_geo.noload (NOLOAD) : { KEEP(build/us_n64/actors/group6_geo.o(.bss*)); } _group6_geoSegmentBssEnd = ADDR(.group6_geo.noload) + SIZEOF(.group6_geo.noload); _group6_geoSegmentBssSize = SIZEOF(.group6_geo.noload); _group6_mio0SegmentRomStart = _group6_yay0SegmentRomStart; _group6_mio0SegmentRomEnd = _group6_yay0SegmentRomEnd;
   _group7_yay0SegmentStart = ADDR(.group7_yay0); _group7_yay0SegmentRomStart = __romPos; .group7_yay0 0x05000000 : AT(__romPos) { KEEP(build/us_n64/actors/group7.szp.o(.data*)); . = ALIGN(0x10); } _group7_yay0SegmentEnd = ADDR(.group7_yay0) + SIZEOF(.group7_yay0); _group7_yay0SegmentRomEnd = __romPos + SIZEOF(.group7_yay0); __romPos += SIZEOF(.group7_yay0); _group7_geoSegmentStart = ADDR(.group7_geo); _group7_geoSegmentRomStart = __romPos; .group7_geo 0x0C000000 : AT(__romPos) { KEEP(build/us_n64/actors/group7_geo.o(.data*)); KEEP(build/us_n64/actors/group7_geo.o(.rodata*)); KEEP(build/us_n64/actors/group7_geo.o(.text*)); } _group7_geoSegmentEnd = ADDR(.group7_geo) + SIZEOF(.group7_geo); _group7_geoSegmentRomEnd = __romPos + SIZEOF(.group7_geo); __romPos += SIZEOF(.group7_geo); _group7_geoSegmentBssStart = ADDR(.group7_geo.noload); .group7_geo.noload (NOLOAD) : { KEEP(build/us_n64/actors/group7_geo.o(.bss*)); } _group7_geoSegmentBssEnd = ADDR(.group7_geo.noload) + SIZEOF(.group7_geo.noload); _group7_geoSegmentBssSize = SIZEOF(.group7_geo.noload); _group7_mio0SegmentRomStart = _group7_yay0SegmentRomStart; _group7_mio0SegmentRomEnd = _group7_yay0SegmentRomEnd;
   _group8_yay0SegmentStart = ADDR(.group8_yay0); _group8_yay0SegmentRomStart = __romPos; .group8_yay0 0x05000000 : AT(__romPos) { KEEP(build/us_n64/actors/group8.szp.o(.data*)); . = ALIGN(0x10); } _group8_yay0SegmentEnd = ADDR(.group8_yay0) + SIZEOF(.group8_yay0); _group8_yay0SegmentRomEnd = __romPos + SIZEOF(.group8_yay0); __romPos += SIZEOF(.group8_yay0); _group8_geoSegmentStart = ADDR(.group8_geo); _group8_geoSegmentRomStart = __romPos; .group8_geo 0x0C000000 : AT(__romPos) { KEEP(build/us_n64/actors/group8_geo.o(.data*)); KEEP(build/us_n64/actors/group8_geo.o(.rodata*)); KEEP(build/us_n64/actors/group8_geo.o(.text*)); } _group8_geoSegmentEnd = ADDR(.group8_geo) + SIZEOF(.group8_geo); _group8_geoSegmentRomEnd = __romPos + SIZEOF(.group8_geo); __romPos += SIZEOF(.group8_geo); _group8_geoSegmentBssStart = ADDR(.group8_geo.noload); .group8_geo.noload (NOLOAD) : { KEEP(build/us_n64/actors/group8_geo.o(.bss*)); } _group8_geoSegmentBssEnd = ADDR(.group8_geo.noload) + SIZEOF(.group8_geo.noload); _group8_geoSegmentBssSize = SIZEOF(.group8_geo.noload); _group8_mio0SegmentRomStart = _group8_yay0SegmentRomStart; _group8_mio0SegmentRomEnd = _group8_yay0SegmentRomEnd;
   _group9_yay0SegmentStart = ADDR(.group9_yay0); _group9_yay0SegmentRomStart = __romPos; .group9_yay0 0x05000000 : AT(__romPos) { KEEP(build/us_n64/actors/group9.szp.o(.data*)); . = ALIGN(0x10); } _group9_yay0SegmentEnd = ADDR(.group9_yay0) + SIZEOF(.group9_yay0); _group9_yay0SegmentRomEnd = __romPos + SIZEOF(.group9_yay0); __romPos += SIZEOF(.group9_yay0); _group9_geoSegmentStart = ADDR(.group9_geo); _group9_geoSegmentRomStart = __romPos; .group9_geo 0x0C000000 : AT(__romPos) { KEEP(build/us_n64/actors/group9_geo.o(.data*)); KEEP(build/us_n64/actors/group9_geo.o(.rodata*)); KEEP(build/us_n64/actors/group9_geo.o(.text*)); } _group9_geoSegmentEnd = ADDR(.group9_geo) + SIZEOF(.group9_geo); _group9_geoSegmentRomEnd = __romPos + SIZEOF(.group9_geo); __romPos += SIZEOF(.group9_geo); _group9_geoSegmentBssStart = ADDR(.group9_geo.noload); .group9_geo.noload (NOLOAD) : { KEEP(build/us_n64/actors/group9_geo.o(.bss*)); } _group9_geoSegmentBssEnd = ADDR(.group9_geo.noload) + SIZEOF(.group9_geo.noload); _group9_geoSegmentBssSize = SIZEOF(.group9_geo.noload); _group9_mio0SegmentRomStart = _group9_yay0SegmentRomStart; _group9_mio0SegmentRomEnd = _group9_yay0SegmentRomEnd;
   _group10_yay0SegmentStart = ADDR(.group10_yay0); _group10_yay0SegmentRomStart = __romPos; .group10_yay0 0x05000000 : AT(__romPos) { KEEP(build/us_n64/actors/group10.szp.o(.data*)); . = ALIGN(0x10); } _group10_yay0SegmentEnd = ADDR(.group10_yay0) + SIZEOF(.group10_yay0); _group10_yay0SegmentRomEnd = __romPos + SIZEOF(.group10_yay0); __romPos += SIZEOF(.group10_yay0); _group10_geoSegmentStart = ADDR(.group10_geo); _group10_geoSegmentRomStart = __romPos; .group10_geo 0x0C000000 : AT(__romPos) { KEEP(build/us_n64/actors/group10_geo.o(.data*)); KEEP(build/us_n64/actors/group10_geo.o(.rodata*)); KEEP(build/us_n64/actors/group10_geo.o(.text*)); } _group10_geoSegmentEnd = ADDR(.group10_geo) + SIZEOF(.group10_geo); _group10_geoSegmentRomEnd = __romPos + SIZEOF(.group10_geo); __romPos += SIZEOF(.group10_geo); _group10_geoSegmentBssStart = ADDR(.group10_geo.noload); .group10_geo.noload (NOLOAD) : { KEEP(build/us_n64/actors/group10_geo.o(.bss*)); } _group10_geoSegmentBssEnd = ADDR(.group10_geo.noload) + SIZEOF(.group10_geo.noload); _group10_geoSegmentBssSize = SIZEOF(.group10_geo.noload); _group10_mio0SegmentRomStart = _group10_yay0SegmentRomStart; _group10_mio0SegmentRomEnd = _group10_yay0SegmentRomEnd;
   _group11_yay0SegmentStart = ADDR(.group11_yay0); _group11_yay0SegmentRomStart = __romPos; .group11_yay0 0x05000000 : AT(__romPos) { KEEP(build/us_n64/actors/group11.szp.o(.data*)); . = ALIGN(0x10); } _group11_yay0SegmentEnd = ADDR(.group11_yay0) + SIZEOF(.group11_yay0); _group11_yay0SegmentRomEnd = __romPos + SIZEOF(.group11_yay0); __romPos += SIZEOF(.group11_yay0); _group11_geoSegmentStart = ADDR(.group11_geo); _group11_geoSegmentRomStart = __romPos; .group11_geo 0x0C000000 : AT(__romPos) { KEEP(build/us_n64/actors/group11_geo.o(.data*)); KEEP(build/us_n64/actors/group11_geo.o(.rodata*)); KEEP(build/us_n64/actors/group11_geo.o(.text*)); } _group11_geoSegmentEnd = ADDR(.group11_geo) + SIZEOF(.group11_geo); _group11_geoSegmentRomEnd = __romPos + SIZEOF(.group11_geo); __romPos += SIZEOF(.group11_geo); _group11_geoSegmentBssStart = ADDR(.group11_geo.noload); .group11_geo.noload (NOLOAD) : { KEEP(build/us_n64/actors/group11_geo.o(.bss*)); } _group11_geoSegmentBssEnd = ADDR(.group11_geo.noload) + SIZEOF(.group11_geo.noload); _group11_geoSegmentBssSize = SIZEOF(.group11_geo.noload); _group11_mio0SegmentRomStart = _group11_yay0SegmentRomStart; _group11_mio0SegmentRomEnd = _group11_yay0SegmentRomEnd;
   _group12_yay0SegmentStart = ADDR(.group12_yay0); _group12_yay0SegmentRomStart = __romPos; .group12_yay0 0x06000000 : AT(__romPos) { KEEP(build/us_n64/actors/group12.szp.o(.data*)); . = ALIGN(0x10); } _group12_yay0SegmentEnd = ADDR(.group12_yay0) + SIZEOF(.group12_yay0); _group12_yay0SegmentRomEnd = __romPos + SIZEOF(.group12_yay0); __romPos += SIZEOF(.group12_yay0); _group12_geoSegmentStart = ADDR(.group12_geo); _group12_geoSegmentRomStart = __romPos; .group12_geo 0x0D000000 : AT(__romPos) { KEEP(build/us_n64/actors/group12_geo.o(.data*)); KEEP(build/us_n64/actors/group12_geo.o(.rodata*)); KEEP(build/us_n64/actors/group12_geo.o(.text*)); } _group12_geoSegmentEnd = ADDR(.group12_geo) + SIZEOF(.group12_geo); _group12_geoSegmentRomEnd = __romPos + SIZEOF(.group12_geo); __romPos += SIZEOF(.group12_geo); _group12_geoSegmentBssStart = ADDR(.group12_geo.noload); .group12_geo.noload (NOLOAD) : { KEEP(build/us_n64/actors/group12_geo.o(.bss*)); } _group12_geoSegmentBssEnd = ADDR(.group12_geo.noload) + SIZEOF(.group12_geo.noload); _group12_geoSegmentBssSize = SIZEOF(.group12_geo.noload); _group12_mio0SegmentRomStart = _group12_yay0SegmentRomStart; _group12_mio0SegmentRomEnd = _group12_yay0SegmentRomEnd;
   _group13_yay0SegmentStart = ADDR(.group13_yay0); _group13_yay0SegmentRomStart = __romPos; .group13_yay0 0x06000000 : AT(__romPos) { KEEP(build/us_n64/actors/group13.szp.o(.data*)); . = ALIGN(0x10); } _group13_yay0SegmentEnd = ADDR(.group13_yay0) + SIZEOF(.group13_yay0); _group13_yay0SegmentRomEnd = __romPos + SIZEOF(.group13_yay0); __romPos += SIZEOF(.group13_yay0); _group13_geoSegmentStart = ADDR(.group13_geo); _group13_geoSegmentRomStart = __romPos; .group13_geo 0x0D000000 : AT(__romPos) { KEEP(build/us_n64/actors/group13_geo.o(.data*)); KEEP(build/us_n64/actors/group13_geo.o(.rodata*)); KEEP(build/us_n64/actors/group13_geo.o(.text*)); } _group13_geoSegmentEnd = ADDR(.group13_geo) + SIZEOF(.group13_geo); _group13_geoSegmentRomEnd = __romPos + SIZEOF(.group13_geo); __romPos += SIZEOF(.group13_geo); _group13_geoSegmentBssStart = ADDR(.group13_geo.noload); .group13_geo.noload (NOLOAD) : { KEEP(build/us_n64/actors/group13_geo.o(.bss*)); } _group13_geoSegmentBssEnd = ADDR(.group13_geo.noload) + SIZEOF(.group13_geo.noload); _group13_geoSegmentBssSize = SIZEOF(.group13_geo.noload); _group13_mio0SegmentRomStart = _group13_yay0SegmentRomStart; _group13_mio0SegmentRomEnd = _group13_yay0SegmentRomEnd;
   _group14_yay0SegmentStart = ADDR(.group14_yay0); _group14_yay0SegmentRomStart = __romPos; .group14_yay0 0x06000000 : AT(__romPos) { KEEP(build/us_n64/actors/group14.szp.o(.data*)); . = ALIGN(0x10); } _group14_yay0SegmentEnd = ADDR(.group14_yay0) + SIZEOF(.group14_yay0); _group14_yay0SegmentRomEnd = __romPos + SIZEOF(.group14_yay0); __romPos += SIZEOF(.group14_yay0); _group14_geoSegmentStart = ADDR(.group14_geo); _group14_geoSegmentRomStart = __romPos; .group14_geo 0x0D000000 : AT(__romPos) { KEEP(build/us_n64/actors/group14_geo.o(.data*)); KEEP(build/us_n64/actors/group14_geo.o(.rodata*)); KEEP(build/us_n64/actors/group14_geo.o(.text*)); } _group14_geoSegmentEnd = ADDR(.group14_geo) + SIZEOF(.group14_geo); _group14_geoSegmentRomEnd = __romPos + SIZEOF(.group14_geo); __romPos += SIZEOF(.group14_geo); _group14_geoSegmentBssStart = ADDR(.group14_geo.noload); .group14_geo.noload (NOLOAD) : { KEEP(build/us_n64/actors/group14_geo.o(.bss*)); } _group14_geoSegmentBssEnd = ADDR(.group14_geo.noload) + SIZEOF(.group14_geo.noload); _group14_geoSegmentBssSize = SIZEOF(.group14_geo.noload); _group14_mio0SegmentRomStart = _group14_yay0SegmentRomStart; _group14_mio0SegmentRomEnd = _group14_yay0SegmentRomEnd;
   _group15_yay0SegmentStart = ADDR(.group15_yay0); _group15_yay0SegmentRomStart = __romPos; .group15_yay0 0x06000000 : AT(__romPos) { KEEP(build/us_n64/actors/group15.szp.o(.data*)); . = ALIGN(0x10); } _group15_yay0SegmentEnd = ADDR(.group15_yay0) + SIZEOF(.group15_yay0); _group15_yay0SegmentRomEnd = __romPos + SIZEOF(.group15_yay0); __romPos += SIZEOF(.group15_yay0); _group15_geoSegmentStart = ADDR(.group15_geo); _group15_geoSegmentRomStart = __romPos; .group15_geo 0x0D000000 : AT(__romPos) { KEEP(build/us_n64/actors/group15_geo.o(.data*)); KEEP(build/us_n64/actors/group15_geo.o(.rodata*)); KEEP(build/us_n64/actors/group15_geo.o(.text*)); } _group15_geoSegmentEnd = ADDR(.group15_geo) + SIZEOF(.group15_geo); _group15_geoSegmentRomEnd = __romPos + SIZEOF(.group15_geo); __romPos += SIZEOF(.group15_geo); _group15_geoSegmentBssStart = ADDR(.group15_geo.noload); .group15_geo.noload (NOLOAD) : { KEEP(build/us_n64/actors/group15_geo.o(.bss*)); } _group15_geoSegmentBssEnd = ADDR(.group15_geo.noload) + SIZEOF(.group15_geo.noload); _group15_geoSegmentBssSize = SIZEOF(.group15_geo.noload); _group15_mio0SegmentRomStart = _group15_yay0SegmentRomStart; _group15_mio0SegmentRomEnd = _group15_yay0SegmentRomEnd;
   _group16_yay0SegmentStart = ADDR(.group16_yay0); _group16_yay0SegmentRomStart = __romPos; .group16_yay0 0x06000000 : AT(__romPos) { KEEP(build/us_n64/actors/group16.szp.o(.data*)); . = ALIGN(0x10); } _group16_yay0SegmentEnd = ADDR(.group16_yay0) + SIZEOF(.group16_yay0); _group16_yay0SegmentRomEnd = __romPos + SIZEOF(.group16_yay0); __romPos += SIZEOF(.group16_yay0); _group16_geoSegmentStart = ADDR(.group16_geo); _group16_geoSegmentRomStart = __romPos; .group16_geo 0x0D000000 : AT(__romPos) { KEEP(build/us_n64/actors/group16_geo.o(.data*)); KEEP(build/us_n64/actors/group16_geo.o(.rodata*)); KEEP(build/us_n64/actors/group16_geo.o(.text*)); } _group16_geoSegmentEnd = ADDR(.group16_geo) + SIZEOF(.group16_geo); _group16_geoSegmentRomEnd = __romPos + SIZEOF(.group16_geo); __romPos += SIZEOF(.group16_geo); _group16_geoSegmentBssStart = ADDR(.group16_geo.noload); .group16_geo.noload (NOLOAD) : { KEEP(build/us_n64/actors/group16_geo.o(.bss*)); } _group16_geoSegmentBssEnd = ADDR(.group16_geo.noload) + SIZEOF(.group16_geo.noload); _group16_geoSegmentBssSize = SIZEOF(.group16_geo.noload); _group16_mio0SegmentRomStart = _group16_yay0SegmentRomStart; _group16_mio0SegmentRomEnd = _group16_yay0SegmentRomEnd;
   _group17_yay0SegmentStart = ADDR(.group17_yay0); _group17_yay0SegmentRomStart = __romPos; .group17_yay0 0x06000000 : AT(__romPos) { KEEP(build/us_n64/actors/group17.szp.o(.data*)); . = ALIGN(0x10); } _group17_yay0SegmentEnd = ADDR(.group17_yay0) + SIZEOF(.group17_yay0); _group17_yay0SegmentRomEnd = __romPos + SIZEOF(.group17_yay0); __romPos += SIZEOF(.group17_yay0); _group17_geoSegmentStart = ADDR(.group17_geo); _group17_geoSegmentRomStart = __romPos; .group17_geo 0x0D000000 : AT(__romPos) { KEEP(build/us_n64/actors/group17_geo.o(.data*)); KEEP(build/us_n64/actors/group17_geo.o(.rodata*)); KEEP(build/us_n64/actors/group17_geo.o(.text*)); } _group17_geoSegmentEnd = ADDR(.group17_geo) + SIZEOF(.group17_geo); _group17_geoSegmentRomEnd = __romPos + SIZEOF(.group17_geo); __romPos += SIZEOF(.group17_geo); _group17_geoSegmentBssStart = ADDR(.group17_geo.noload); .group17_geo.noload (NOLOAD) : { KEEP(build/us_n64/actors/group17_geo.o(.bss*)); } _group17_geoSegmentBssEnd = ADDR(.group17_geo.noload) + SIZEOF(.group17_geo.noload); _group17_geoSegmentBssSize = SIZEOF(.group17_geo.noload); _group17_mio0SegmentRomStart = _group17_yay0SegmentRomStart; _group17_mio0SegmentRomEnd = _group17_yay0SegmentRomEnd;
   _common0_yay0SegmentStart = ADDR(.common0_yay0); _common0_yay0SegmentRomStart = __romPos; .common0_yay0 0x08000000 : AT(__romPos) { KEEP(build/us_n64/actors/common0.szp.o(.data*)); . = ALIGN(0x10); } _common0_yay0SegmentEnd = ADDR(.common0_yay0) + SIZEOF(.common0_yay0); _common0_yay0SegmentRomEnd = __romPos + SIZEOF(.common0_yay0); __romPos += SIZEOF(.common0_yay0); _common0_geoSegmentStart = ADDR(.common0_geo); _common0_geoSegmentRomStart = __romPos; .common0_geo 0x0F000000 : AT(__romPos) { KEEP(build/us_n64/actors/common0_geo.o(.data*)); KEEP(build/us_n64/actors/common0_geo.o(.rodata*)); KEEP(build/us_n64/actors/common0_geo.o(.text*)); } _common0_geoSegmentEnd = ADDR(.common0_geo) + SIZEOF(.common0_geo); _common0_geoSegmentRomEnd = __romPos + SIZEOF(.common0_geo); __romPos += SIZEOF(.common0_geo); _common0_geoSegmentBssStart = ADDR(.common0_geo.noload); .common0_geo.noload (NOLOAD) : { KEEP(build/us_n64/actors/common0_geo.o(.bss*)); } _common0_geoSegmentBssEnd = ADDR(.common0_geo.noload) + SIZEOF(.common0_geo.noload); _common0_geoSegmentBssSize = SIZEOF(.common0_geo.noload); _common0_mio0SegmentRomStart = _common0_yay0SegmentRomStart; _common0_mio0SegmentRomEnd = _common0_yay0SegmentRomEnd;
   _common1_yay0SegmentStart = ADDR(.common1_yay0); _common1_yay0SegmentRomStart = __romPos; .common1_yay0 0x03000000 : AT(__romPos) { KEEP(build/us_n64/actors/common1.szp.o(.data*)); . = ALIGN(0x10); } _common1_yay0SegmentEnd = ADDR(.common1_yay0) + SIZEOF(.common1_yay0); _common1_yay0SegmentRomEnd = __romPos + SIZEOF(.common1_yay0); __romPos += SIZEOF(.common1_yay0); _common1_geoSegmentStart = ADDR(.common1_geo); _common1_geoSegmentRomStart = __romPos; .common1_geo 0x16000000 : AT(__romPos) { KEEP(build/us_n64/actors/common1_geo.o(.data*)); KEEP(build/us_n64/actors/common1_geo.o(.rodata*)); KEEP(build/us_n64/actors/common1_geo.o(.text*)); } _common1_geoSegmentEnd = ADDR(.common1_geo) + SIZEOF(.common1_geo); _common1_geoSegmentRomEnd = __romPos + SIZEOF(.common1_geo); __romPos += SIZEOF(.common1_geo); _common1_geoSegmentBssStart = ADDR(.common1_geo.noload); .common1_geo.noload (NOLOAD) : { KEEP(build/us_n64/actors/common1_geo.o(.bss*)); } _common1_geoSegmentBssEnd = ADDR(.common1_geo.noload) + SIZEOF(.common1_geo.noload); _common1_geoSegmentBssSize = SIZEOF(.common1_geo.noload); _common1_mio0SegmentRomStart = _common1_yay0SegmentRomStart; _common1_mio0SegmentRomEnd = _common1_yay0SegmentRomEnd;
   _vo_bob_yay0SegmentStart = ADDR(.vo_bob_yay0); _vo_bob_yay0SegmentRomStart = __romPos; .vo_bob_yay0 0x0e000000 : AT(__romPos) { KEEP(build/us_n64/actors/vanilla_actors/bob/data.szp.o(.data*)); . = ALIGN(0x10); } _vo_bob_yay0SegmentEnd = ADDR(.vo_bob_yay0) + SIZEOF(.vo_bob_yay0); _vo_bob_yay0SegmentRomEnd = __romPos + SIZEOF(.vo_bob_yay0); __romPos += SIZEOF(.vo_bob_yay0); _vo_bob_geoSegmentStart = ADDR(.vo_bob_geo); _vo_bob_geoSegmentRomStart = __romPos; .vo_bob_geo 0x1a000000 : AT(__romPos) { KEEP(build/us_n64/actors/vanilla_actors/bob/geo.o(.data*)); KEEP(build/us_n64/actors/vanilla_actors/bob/geo.o(.rodata*)); KEEP(build/us_n64/actors/vanilla_actors/bob/geo.o(.text*)); } _vo_bob_geoSegmentEnd = ADDR(.vo_bob_geo) + SIZEOF(.vo_bob_geo); _vo_bob_geoSegmentRomEnd = __romPos + SIZEOF(.vo_bob_geo); __romPos += SIZEOF(.vo_bob_geo); _vo_bob_geoSegmentBssStart = ADDR(.vo_bob_geo.noload); .vo_bob_geo.noload (NOLOAD) : { KEEP(build/us_n64/actors/vanilla_actors/bob/geo.o(.bss*)); } _vo_bob_geoSegmentBssEnd = ADDR(.vo_bob_geo.noload) + SIZEOF(.vo_bob_geo.noload); _vo_bob_geoSegmentBssSize = SIZEOF(.vo_bob_geo.noload); _vo_bob_mio0SegmentRomStart = _vo_bob_yay0SegmentRomStart; _vo_bob_mio0SegmentRomEnd = _vo_bob_yay0SegmentRomEnd;
   _vo_wf_yay0SegmentStart = ADDR(.vo_wf_yay0); _vo_wf_yay0SegmentRomStart = __romPos; .vo_wf_yay0 0x0e000000 : AT(__romPos) { KEEP(build/us_n64/actors/vanilla_actors/wf/data.szp.o(.data*)); . = ALIGN(0x10); } _vo_wf_yay0SegmentEnd = ADDR(.vo_wf_yay0) + SIZEOF(.vo_wf_yay0); _vo_wf_yay0SegmentRomEnd = __romPos + SIZEOF(.vo_wf_yay0); __romPos += SIZEOF(.vo_wf_yay0); _vo_wf_geoSegmentStart = ADDR(.vo_wf_geo); _vo_wf_geoSegmentRomStart = __romPos; .vo_wf_geo 0x1a000000 : AT(__romPos) { KEEP(build/us_n64/actors/vanilla_actors/wf/geo.o(.data*)); KEEP(build/us_n64/actors/vanilla_actors/wf/geo.o(.rodata*)); KEEP(build/us_n64/actors/vanilla_actors/wf/geo.o(.text*)); } _vo_wf_geoSegmentEnd = ADDR(.vo_wf_geo) + SIZEOF(.vo_wf_geo); _vo_wf_geoSegmentRomEnd = __romPos + SIZEOF(.vo_wf_geo); __romPos += SIZEOF(.vo_wf_geo); _vo_wf_geoSegmentBssStart = ADDR(.vo_wf_geo.noload); .vo_wf_geo.noload (NOLOAD) : { KEEP(build/us_n64/actors/vanilla_actors/wf/geo.o(.bss*)); } _vo_wf_geoSegmentBssEnd = ADDR(.vo_wf_geo.noload) + SIZEOF(.vo_wf_geo.noload); _vo_wf_geoSegmentBssSize = SIZEOF(.vo_wf_geo.noload); _vo_wf_mio0SegmentRomStart = _vo_wf_yay0SegmentRomStart; _vo_wf_mio0SegmentRomEnd = _vo_wf_yay0SegmentRomEnd;
   _vo_jrb_yay0SegmentStart = ADDR(.vo_jrb_yay0); _vo_jrb_yay0SegmentRomStart = __romPos; .vo_jrb_yay0 0x0e000000 : AT(__romPos) { KEEP(build/us_n64/actors/vanilla_actors/jrb/data.szp.o(.data*)); . = ALIGN(0x10); } _vo_jrb_yay0SegmentEnd = ADDR(.vo_jrb_yay0) + SIZEOF(.vo_jrb_yay0); _vo_jrb_yay0SegmentRomEnd = __romPos + SIZEOF(.vo_jrb_yay0); __romPos += SIZEOF(.vo_jrb_yay0); _vo_jrb_geoSegmentStart = ADDR(.vo_jrb_geo); _vo_jrb_geoSegmentRomStart = __romPos; .vo_jrb_geo 0x1a000000 : AT(__romPos) { KEEP(build/us_n64/actors/vanilla_actors/jrb/geo.o(.data*)); KEEP(build/us_n64/actors/vanilla_actors/jrb/geo.o(.rodata*)); KEEP(build/us_n64/actors/vanilla_actors/jrb/geo.o(.text*)); } _vo_jrb_geoSegmentEnd = ADDR(.vo_jrb_geo) + SIZEOF(.vo_jrb_geo); _vo_jrb_geoSegmentRomEnd = __romPos + SIZEOF(.vo_jrb_geo); __romPos += SIZEOF(.vo_jrb_geo); _vo_jrb_geoSegmentBssStart = ADDR(.vo_jrb_geo.noload); .vo_jrb_geo.noload (NOLOAD) : { KEEP(build/us_n64/actors/vanilla_actors/jrb/geo.o(.bss*)); } _vo_jrb_geoSegmentBssEnd = ADDR(.vo_jrb_geo.noload) + SIZEOF(.vo_jrb_geo.noload); _vo_jrb_geoSegmentBssSize = SIZEOF(.vo_jrb_geo.noload); _vo_jrb_mio0SegmentRomStart = _vo_jrb_yay0SegmentRomStart; _vo_jrb_mio0SegmentRomEnd = _vo_jrb_yay0SegmentRomEnd;
   _vo_ccm_yay0SegmentStart = ADDR(.vo_ccm_yay0); _vo_ccm_yay0SegmentRomStart = __romPos; .vo_ccm_yay0 0x0e000000 : AT(__romPos) { KEEP(build/us_n64/actors/vanilla_actors/ccm/data.szp.o(.data*)); . = ALIGN(0x10); } _vo_ccm_yay0SegmentEnd = ADDR(.vo_ccm_yay0) + SIZEOF(.vo_ccm_yay0); _vo_ccm_yay0SegmentRomEnd = __romPos + SIZEOF(.vo_ccm_yay0); __romPos += SIZEOF(.vo_ccm_yay0); _vo_ccm_geoSegmentStart = ADDR(.vo_ccm_geo); _vo_ccm_geoSegmentRomStart = __romPos; .vo_ccm_geo 0x1a000000 : AT(__romPos) { KEEP(build/us_n64/actors/vanilla_actors/ccm/geo.o(.data*)); KEEP(build/us_n64/actors/vanilla_actors/ccm/geo.o(.rodata*)); KEEP(build/us_n64/actors/vanilla_actors/ccm/geo.o(.text*)); } _vo_ccm_geoSegmentEnd = ADDR(.vo_ccm_geo) + SIZEOF(.vo_ccm_geo); _vo_ccm_geoSegmentRomEnd = __romPos + SIZEOF(.vo_ccm_geo); __romPos += SIZEOF(.vo_ccm_geo); _vo_ccm_geoSegmentBssStart = ADDR(.vo_ccm_geo.noload); .vo_ccm_geo.noload (NOLOAD) : { KEEP(build/us_n64/actors/vanilla_actors/ccm/geo.o(.bss*)); } _vo_ccm_geoSegmentBssEnd = ADDR(.vo_ccm_geo.noload) + SIZEOF(.vo_ccm_geo.noload); _vo_ccm_geoSegmentBssSize = SIZEOF(.vo_ccm_geo.noload); _vo_ccm_mio0SegmentRomStart = _vo_ccm_yay0SegmentRomStart; _vo_ccm_mio0SegmentRomEnd = _vo_ccm_yay0SegmentRomEnd;
   _vo_bbh_yay0SegmentStart = ADDR(.vo_bbh_yay0); _vo_bbh_yay0SegmentRomStart = __romPos; .vo_bbh_yay0 0x0e000000 : AT(__romPos) { KEEP(build/us_n64/actors/vanilla_actors/bbh/data.szp.o(.data*)); . = ALIGN(0x10); } _vo_bbh_yay0SegmentEnd = ADDR(.vo_bbh_yay0) + SIZEOF(.vo_bbh_yay0); _vo_bbh_yay0SegmentRomEnd = __romPos + SIZEOF(.vo_bbh_yay0); __romPos += SIZEOF(.vo_bbh_yay0); _vo_bbh_geoSegmentStart = ADDR(.vo_bbh_geo); _vo_bbh_geoSegmentRomStart = __romPos; .vo_bbh_geo 0x1a000000 : AT(__romPos) { KEEP(build/us_n64/actors/vanilla_actors/bbh/geo.o(.data*)); KEEP(build/us_n64/actors/vanilla_actors/bbh/geo.o(.rodata*)); KEEP(build/us_n64/actors/vanilla_actors/bbh/geo.o(.text*)); } _vo_bbh_geoSegmentEnd = ADDR(.vo_bbh_geo) + SIZEOF(.vo_bbh_geo); _vo_bbh_geoSegmentRomEnd = __romPos + SIZEOF(.vo_bbh_geo); __romPos += SIZEOF(.vo_bbh_geo); _vo_bbh_geoSegmentBssStart = ADDR(.vo_bbh_geo.noload); .vo_bbh_geo.noload (NOLOAD) : { KEEP(build/us_n64/actors/vanilla_actors/bbh/geo.o(.bss*)); } _vo_bbh_geoSegmentBssEnd = ADDR(.vo_bbh_geo.noload) + SIZEOF(.vo_bbh_geo.noload); _vo_bbh_geoSegmentBssSize = SIZEOF(.vo_bbh_geo.noload); _vo_bbh_mio0SegmentRomStart = _vo_bbh_yay0SegmentRomStart; _vo_bbh_mio0SegmentRomEnd = _vo_bbh_yay0SegmentRomEnd;
   _vo_hmc_yay0SegmentStart = ADDR(.vo_hmc_yay0); _vo_hmc_yay0SegmentRomStart = __romPos; .vo_hmc_yay0 0x0e000000 : AT(__romPos) { KEEP(build/us_n64/actors/vanilla_actors/hmc/data.szp.o(.data*)); . = ALIGN(0x10); } _vo_hmc_yay0SegmentEnd = ADDR(.vo_hmc_yay0) + SIZEOF(.vo_hmc_yay0); _vo_hmc_yay0SegmentRomEnd = __romPos + SIZEOF(.vo_hmc_yay0); __romPos += SIZEOF(.vo_hmc_yay0); _vo_hmc_geoSegmentStart = ADDR(.vo_hmc_geo); _vo_hmc_geoSegmentRomStart = __romPos; .vo_hmc_geo 0x1a000000 : AT(__romPos) { KEEP(build/us_n64/actors/vanilla_actors/hmc/geo.o(.data*)); KEEP(build/us_n64/actors/vanilla_actors/hmc/geo.o(.rodata*)); KEEP(build/us_n64/actors/vanilla_actors/hmc/geo.o(.text*)); } _vo_hmc_geoSegmentEnd = ADDR(.vo_hmc_geo) + SIZEOF(.vo_hmc_geo); _vo_hmc_geoSegmentRomEnd = __romPos + SIZEOF(.vo_hmc_geo); __romPos += SIZEOF(.vo_hmc_geo); _vo_hmc_geoSegmentBssStart = ADDR(.vo_hmc_geo.noload); .vo_hmc_geo.noload (NOLOAD) : { KEEP(build/us_n64/actors/vanilla_actors/hmc/geo.o(.bss*)); } _vo_hmc_geoSegmentBssEnd = ADDR(.vo_hmc_geo.noload) + SIZEOF(.vo_hmc_geo.noload); _vo_hmc_geoSegmentBssSize = SIZEOF(.vo_hmc_geo.noload); _vo_hmc_mio0SegmentRomStart = _vo_hmc_yay0SegmentRomStart; _vo_hmc_mio0SegmentRomEnd = _vo_hmc_yay0SegmentRomEnd;
   _vo_lll_yay0SegmentStart = ADDR(.vo_lll_yay0); _vo_lll_yay0SegmentRomStart = __romPos; .vo_lll_yay0 0x0e000000 : AT(__romPos) { KEEP(build/us_n64/actors/vanilla_actors/lll/data.szp.o(.data*)); . = ALIGN(0x10); } _vo_lll_yay0SegmentEnd = ADDR(.vo_lll_yay0) + SIZEOF(.vo_lll_yay0); _vo_lll_yay0SegmentRomEnd = __romPos + SIZEOF(.vo_lll_yay0); __romPos += SIZEOF(.vo_lll_yay0); _vo_lll_geoSegmentStart = ADDR(.vo_lll_geo); _vo_lll_geoSegmentRomStart = __romPos; .vo_lll_geo 0x1a000000 : AT(__romPos) { KEEP(build/us_n64/actors/vanilla_actors/lll/geo.o(.data*)); KEEP(build/us_n64/actors/vanilla_actors/lll/geo.o(.rodata*)); KEEP(build/us_n64/actors/vanilla_actors/lll/geo.o(.text*)); } _vo_lll_geoSegmentEnd = ADDR(.vo_lll_geo) + SIZEOF(.vo_lll_geo); _vo_lll_geoSegmentRomEnd = __romPos + SIZEOF(.vo_lll_geo); __romPos += SIZEOF(.vo_lll_geo); _vo_lll_geoSegmentBssStart = ADDR(.vo_lll_geo.noload); .vo_lll_geo.noload (NOLOAD) : { KEEP(build/us_n64/actors/vanilla_actors/lll/geo.o(.bss*)); } _vo_lll_geoSegmentBssEnd = ADDR(.vo_lll_geo.noload) + SIZEOF(.vo_lll_geo.noload); _vo_lll_geoSegmentBssSize = SIZEOF(.vo_lll_geo.noload); _vo_lll_mio0SegmentRomStart = _vo_lll_yay0SegmentRomStart; _vo_lll_mio0SegmentRomEnd = _vo_lll_yay0SegmentRomEnd;
   _vo_ssl_yay0SegmentStart = ADDR(.vo_ssl_yay0); _vo_ssl_yay0SegmentRomStart = __romPos; .vo_ssl_yay0 0x0e000000 : AT(__romPos) { KEEP(build/us_n64/actors/vanilla_actors/ssl/data.szp.o(.data*)); . = ALIGN(0x10); } _vo_ssl_yay0SegmentEnd = ADDR(.vo_ssl_yay0) + SIZEOF(.vo_ssl_yay0); _vo_ssl_yay0SegmentRomEnd = __romPos + SIZEOF(.vo_ssl_yay0); __romPos += SIZEOF(.vo_ssl_yay0); _vo_ssl_geoSegmentStart = ADDR(.vo_ssl_geo); _vo_ssl_geoSegmentRomStart = __romPos; .vo_ssl_geo 0x1a000000 : AT(__romPos) { KEEP(build/us_n64/actors/vanilla_actors/ssl/geo.o(.data*)); KEEP(build/us_n64/actors/vanilla_actors/ssl/geo.o(.rodata*)); KEEP(build/us_n64/actors/vanilla_actors/ssl/geo.o(.text*)); } _vo_ssl_geoSegmentEnd = ADDR(.vo_ssl_geo) + SIZEOF(.vo_ssl_geo); _vo_ssl_geoSegmentRomEnd = __romPos + SIZEOF(.vo_ssl_geo); __romPos += SIZEOF(.vo_ssl_geo); _vo_ssl_geoSegmentBssStart = ADDR(.vo_ssl_geo.noload); .vo_ssl_geo.noload (NOLOAD) : { KEEP(build/us_n64/actors/vanilla_actors/ssl/geo.o(.bss*)); } _vo_ssl_geoSegmentBssEnd = ADDR(.vo_ssl_geo.noload) + SIZEOF(.vo_ssl_geo.noload); _vo_ssl_geoSegmentBssSize = SIZEOF(.vo_ssl_geo.noload); _vo_ssl_mio0SegmentRomStart = _vo_ssl_yay0SegmentRomStart; _vo_ssl_mio0SegmentRomEnd = _vo_ssl_yay0SegmentRomEnd;
   _vo_ddd_yay0SegmentStart = ADDR(.vo_ddd_yay0); _vo_ddd_yay0SegmentRomStart = __romPos; .vo_ddd_yay0 0x0e000000 : AT(__romPos) { KEEP(build/us_n64/actors/vanilla_actors/ddd/data.szp.o(.data*)); . = ALIGN(0x10); } _vo_ddd_yay0SegmentEnd = ADDR(.vo_ddd_yay0) + SIZEOF(.vo_ddd_yay0); _vo_ddd_yay0SegmentRomEnd = __romPos + SIZEOF(.vo_ddd_yay0); __romPos += SIZEOF(.vo_ddd_yay0); _vo_ddd_geoSegmentStart = ADDR(.vo_ddd_geo); _vo_ddd_geoSegmentRomStart = __romPos; .vo_ddd_geo 0x1a000000 : AT(__romPos) { KEEP(build/us_n64/actors/vanilla_actors/ddd/geo.o(.data*)); KEEP(build/us_n64/actors/vanilla_actors/ddd/geo.o(.rodata*)); KEEP(build/us_n64/actors/vanilla_actors/ddd/geo.o(.text*)); } _vo_ddd_geoSegmentEnd = ADDR(.vo_ddd_geo) + SIZEOF(.vo_ddd_geo); _vo_ddd_geoSegmentRomEnd = __romPos + SIZEOF(.vo_ddd_geo); __romPos += SIZEOF(.vo_ddd_geo); _vo_ddd_geoSegmentBssStart = ADDR(.vo_ddd_geo.noload); .vo_ddd_geo.noload (NOLOAD) : { KEEP(build/us_n64/actors/vanilla_actors/ddd/geo.o(.bss*)); } _vo_ddd_geoSegmentBssEnd = ADDR(.vo_ddd_geo.noload) + SIZEOF(.vo_ddd_geo.noload); _vo_ddd_geoSegmentBssSize = SIZEOF(.vo_ddd_geo.noload); _vo_ddd_mio0SegmentRomStart = _vo_ddd_yay0SegmentRomStart; _vo_ddd_mio0SegmentRomEnd = _vo_ddd_yay0SegmentRomEnd;
   _vo_sl_yay0SegmentStart = ADDR(.vo_sl_yay0); _vo_sl_yay0SegmentRomStart = __romPos; .vo_sl_yay0 0x0e000000 : AT(__romPos) { KEEP(build/us_n64/actors/vanilla_actors/sl/data.szp.o(.data*)); . = ALIGN(0x10); } _vo_sl_yay0SegmentEnd = ADDR(.vo_sl_yay0) + SIZEOF(.vo_sl_yay0); _vo_sl_yay0SegmentRomEnd = __romPos + SIZEOF(.vo_sl_yay0); __romPos += SIZEOF(.vo_sl_yay0); _vo_sl_geoSegmentStart = ADDR(.vo_sl_geo); _vo_sl_geoSegmentRomStart = __romPos; .vo_sl_geo 0x1a000000 : AT(__romPos) { KEEP(build/us_n64/actors/vanilla_actors/sl/geo.o(.data*)); KEEP(build/us_n64/actors/vanilla_actors/sl/geo.o(.rodata*)); KEEP(build/us_n64/actors/vanilla_actors/sl/geo.o(.text*)); } _vo_sl_geoSegmentEnd = ADDR(.vo_sl_geo) + SIZEOF(.vo_sl_geo); _vo_sl_geoSegmentRomEnd = __romPos + SIZEOF(.vo_sl_geo); __romPos += SIZEOF(.vo_sl_geo); _vo_sl_geoSegmentBssStart = ADDR(.vo_sl_geo.noload); .vo_sl_geo.noload (NOLOAD) : { KEEP(build/us_n64/actors/vanilla_actors/sl/geo.o(.bss*)); } _vo_sl_geoSegmentBssEnd = ADDR(.vo_sl_geo.noload) + SIZEOF(.vo_sl_geo.noload); _vo_sl_geoSegmentBssSize = SIZEOF(.vo_sl_geo.noload); _vo_sl_mio0SegmentRomStart = _vo_sl_yay0SegmentRomStart; _vo_sl_mio0SegmentRomEnd = _vo_sl_yay0SegmentRomEnd;
   _vo_wdw_yay0SegmentStart = ADDR(.vo_wdw_yay0); _vo_wdw_yay0SegmentRomStart = __romPos; .vo_wdw_yay0 0x0e000000 : AT(__romPos) { KEEP(build/us_n64/actors/vanilla_actors/wdw/data.szp.o(.data*)); . = ALIGN(0x10); } _vo_wdw_yay0SegmentEnd = ADDR(.vo_wdw_yay0) + SIZEOF(.vo_wdw_yay0); _vo_wdw_yay0SegmentRomEnd = __romPos + SIZEOF(.vo_wdw_yay0); __romPos += SIZEOF(.vo_wdw_yay0); _vo_wdw_geoSegmentStart = ADDR(.vo_wdw_geo); _vo_wdw_geoSegmentRomStart = __romPos; .vo_wdw_geo 0x1a000000 : AT(__romPos) { KEEP(build/us_n64/actors/vanilla_actors/wdw/geo.o(.data*)); KEEP(build/us_n64/actors/vanilla_actors/wdw/geo.o(.rodata*)); KEEP(build/us_n64/actors/vanilla_actors/wdw/geo.o(.text*)); } _vo_wdw_geoSegmentEnd = ADDR(.vo_wdw_geo) + SIZEOF(.vo_wdw_geo); _vo_wdw_geoSegmentRomEnd = __romPos + SIZEOF(.vo_wdw_geo); __romPos += SIZEOF(.vo_wdw_geo); _vo_wdw_geoSegmentBssStart = ADDR(.vo_wdw_geo.noload); .vo_wdw_geo.noload (NOLOAD) : { KEEP(build/us_n64/actors/vanilla_actors/wdw/geo.o(.bss*)); } _vo_wdw_geoSegmentBssEnd = ADDR(.vo_wdw_geo.noload) + SIZEOF(.vo_wdw_geo.noload); _vo_wdw_geoSegmentBssSize = SIZEOF(.vo_wdw_geo.noload); _vo_wdw_mio0SegmentRomStart = _vo_wdw_yay0SegmentRomStart; _vo_wdw_mio0SegmentRomEnd = _vo_wdw_yay0SegmentRomEnd;
   _vo_ttm_yay0SegmentStart = ADDR(.vo_ttm_yay0); _vo_ttm_yay0SegmentRomStart = __romPos; .vo_ttm_yay0 0x0e000000 : AT(__romPos) { KEEP(build/us_n64/actors/vanilla_actors/ttm/data.szp.o(.data*)); . = ALIGN(0x10); } _vo_ttm_yay0SegmentEnd = ADDR(.vo_ttm_yay0) + SIZEOF(.vo_ttm_yay0); _vo_ttm_yay0SegmentRomEnd = __romPos + SIZEOF(.vo_ttm_yay0); __romPos += SIZEOF(.vo_ttm_yay0); _vo_ttm_geoSegmentStart = ADDR(.vo_ttm_geo); _vo_ttm_geoSegmentRomStart = __romPos; .vo_ttm_geo 0x1a000000 : AT(__romPos) { KEEP(build/us_n64/actors/vanilla_actors/ttm/geo.o(.data*)); KEEP(build/us_n64/actors/vanilla_actors/ttm/geo.o(.rodata*)); KEEP(build/us_n64/actors/vanilla_actors/ttm/geo.o(.text*)); } _vo_ttm_geoSegmentEnd = ADDR(.vo_ttm_geo) + SIZEOF(.vo_ttm_geo); _vo_ttm_geoSegmentRomEnd = __romPos + SIZEOF(.vo_ttm_geo); __romPos += SIZEOF(.vo_ttm_geo); _vo_ttm_geoSegmentBssStart = ADDR(.vo_ttm_geo.noload); .vo_ttm_geo.noload (NOLOAD) : { KEEP(build/us_n64/actors/vanilla_actors/ttm/geo.o(.bss*)); } _vo_ttm_geoSegmentBssEnd = ADDR(.vo_ttm_geo.noload) + SIZEOF(.vo_ttm_geo.noload); _vo_ttm_geoSegmentBssSize = SIZEOF(.vo_ttm_geo.noload); _vo_ttm_mio0SegmentRomStart = _vo_ttm_yay0SegmentRomStart; _vo_ttm_mio0SegmentRomEnd = _vo_ttm_yay0SegmentRomEnd;
   _vo_thi_yay0SegmentStart = ADDR(.vo_thi_yay0); _vo_thi_yay0SegmentRomStart = __romPos; .vo_thi_yay0 0x0e000000 : AT(__romPos) { KEEP(build/us_n64/actors/vanilla_actors/thi/data.szp.o(.data*)); . = ALIGN(0x10); } _vo_thi_yay0SegmentEnd = ADDR(.vo_thi_yay0) + SIZEOF(.vo_thi_yay0); _vo_thi_yay0SegmentRomEnd = __romPos + SIZEOF(.vo_thi_yay0); __romPos += SIZEOF(.vo_thi_yay0); _vo_thi_geoSegmentStart = ADDR(.vo_thi_geo); _vo_thi_geoSegmentRomStart = __romPos; .vo_thi_geo 0x1a000000 : AT(__romPos) { KEEP(build/us_n64/actors/vanilla_actors/thi/geo.o(.data*)); KEEP(build/us_n64/actors/vanilla_actors/thi/geo.o(.rodata*)); KEEP(build/us_n64/actors/vanilla_actors/thi/geo.o(.text*)); } _vo_thi_geoSegmentEnd = ADDR(.vo_thi_geo) + SIZEOF(.vo_thi_geo); _vo_thi_geoSegmentRomEnd = __romPos + SIZEOF(.vo_thi_geo); __romPos += SIZEOF(.vo_thi_geo); _vo_thi_geoSegmentBssStart = ADDR(.vo_thi_geo.noload); .vo_thi_geo.noload (NOLOAD) : { KEEP(build/us_n64/actors/vanilla_actors/thi/geo.o(.bss*)); } _vo_thi_geoSegmentBssEnd = ADDR(.vo_thi_geo.noload) + SIZEOF(.vo_thi_geo.noload); _vo_thi_geoSegmentBssSize = SIZEOF(.vo_thi_geo.noload); _vo_thi_mio0SegmentRomStart = _vo_thi_yay0SegmentRomStart; _vo_thi_mio0SegmentRomEnd = _vo_thi_yay0SegmentRomEnd;
   _vo_ttc_yay0SegmentStart = ADDR(.vo_ttc_yay0); _vo_ttc_yay0SegmentRomStart = __romPos; .vo_ttc_yay0 0x0e000000 : AT(__romPos) { KEEP(build/us_n64/actors/vanilla_actors/ttc/data.szp.o(.data*)); . = ALIGN(0x10); } _vo_ttc_yay0SegmentEnd = ADDR(.vo_ttc_yay0) + SIZEOF(.vo_ttc_yay0); _vo_ttc_yay0SegmentRomEnd = __romPos + SIZEOF(.vo_ttc_yay0); __romPos += SIZEOF(.vo_ttc_yay0); _vo_ttc_geoSegmentStart = ADDR(.vo_ttc_geo); _vo_ttc_geoSegmentRomStart = __romPos; .vo_ttc_geo 0x1a000000 : AT(__romPos) { KEEP(build/us_n64/actors/vanilla_actors/ttc/geo.o(.data*)); KEEP(build/us_n64/actors/vanilla_actors/ttc/geo.o(.rodata*)); KEEP(build/us_n64/actors/vanilla_actors/ttc/geo.o(.text*)); } _vo_ttc_geoSegmentEnd = ADDR(.vo_ttc_geo) + SIZEOF(.vo_ttc_geo); _vo_ttc_geoSegmentRomEnd = __romPos + SIZEOF(.vo_ttc_geo); __romPos += SIZEOF(.vo_ttc_geo); _vo_ttc_geoSegmentBssStart = ADDR(.vo_ttc_geo.noload); .vo_ttc_geo.noload (NOLOAD) : { KEEP(build/us_n64/actors/vanilla_actors/ttc/geo.o(.bss*)); } _vo_ttc_geoSegmentBssEnd = ADDR(.vo_ttc_geo.noload) + SIZEOF(.vo_ttc_geo.noload); _vo_ttc_geoSegmentBssSize = SIZEOF(.vo_ttc_geo.noload); _vo_ttc_mio0SegmentRomStart = _vo_ttc_yay0SegmentRomStart; _vo_ttc_mio0SegmentRomEnd = _vo_ttc_yay0SegmentRomEnd;
   _vo_rr_yay0SegmentStart = ADDR(.vo_rr_yay0); _vo_rr_yay0SegmentRomStart = __romPos; .vo_rr_yay0 0x0e000000 : AT(__romPos) { KEEP(build/us_n64/actors/vanilla_actors/rr/data.szp.o(.data*)); . = ALIGN(0x10); } _vo_rr_yay0SegmentEnd = ADDR(.vo_rr_yay0) + SIZEOF(.vo_rr_yay0); _vo_rr_yay0SegmentRomEnd = __romPos + SIZEOF(.vo_rr_yay0); __romPos += SIZEOF(.vo_rr_yay0); _vo_rr_geoSegmentStart = ADDR(.vo_rr_geo); _vo_rr_geoSegmentRomStart = __romPos; .vo_rr_geo 0x1a000000 : AT(__romPos) { KEEP(build/us_n64/actors/vanilla_actors/rr/geo.o(.data*)); KEEP(build/us_n64/actors/vanilla_actors/rr/geo.o(.rodata*)); KEEP(build/us_n64/actors/vanilla_actors/rr/geo.o(.text*)); } _vo_rr_geoSegmentEnd = ADDR(.vo_rr_geo) + SIZEOF(.vo_rr_geo); _vo_rr_geoSegmentRomEnd = __romPos + SIZEOF(.vo_rr_geo); __romPos += SIZEOF(.vo_rr_geo); _vo_rr_geoSegmentBssStart = ADDR(.vo_rr_geo.noload); .vo_rr_geo.noload (NOLOAD) : { KEEP(build/us_n64/actors/vanilla_actors/rr/geo.o(.bss*)); } _vo_rr_geoSegmentBssEnd = ADDR(.vo_rr_geo.noload) + SIZEOF(.vo_rr_geo.noload); _vo_rr_geoSegmentBssSize = SIZEOF(.vo_rr_geo.noload); _vo_rr_mio0SegmentRomStart = _vo_rr_yay0SegmentRomStart; _vo_rr_mio0SegmentRomEnd = _vo_rr_yay0SegmentRomEnd;
   _vo_bitdw_yay0SegmentStart = ADDR(.vo_bitdw_yay0); _vo_bitdw_yay0SegmentRomStart = __romPos; .vo_bitdw_yay0 0x0e000000 : AT(__romPos) { KEEP(build/us_n64/actors/vanilla_actors/bitdw/data.szp.o(.data*)); . = ALIGN(0x10); } _vo_bitdw_yay0SegmentEnd = ADDR(.vo_bitdw_yay0) + SIZEOF(.vo_bitdw_yay0); _vo_bitdw_yay0SegmentRomEnd = __romPos + SIZEOF(.vo_bitdw_yay0); __romPos += SIZEOF(.vo_bitdw_yay0); _vo_bitdw_geoSegmentStart = ADDR(.vo_bitdw_geo); _vo_bitdw_geoSegmentRomStart = __romPos; .vo_bitdw_geo 0x1a000000 : AT(__romPos) { KEEP(build/us_n64/actors/vanilla_actors/bitdw/geo.o(.data*)); KEEP(build/us_n64/actors/vanilla_actors/bitdw/geo.o(.rodata*)); KEEP(build/us_n64/actors/vanilla_actors/bitdw/geo.o(.text*)); } _vo_bitdw_geoSegmentEnd = ADDR(.vo_bitdw_geo) + SIZEOF(.vo_bitdw_geo); _vo_bitdw_geoSegmentRomEnd = __romPos + SIZEOF(.vo_bitdw_geo); __romPos += SIZEOF(.vo_bitdw_geo); _vo_bitdw_geoSegmentBssStart = ADDR(.vo_bitdw_geo.noload); .vo_bitdw_geo.noload (NOLOAD) : { KEEP(build/us_n64/actors/vanilla_actors/bitdw/geo.o(.bss*)); } _vo_bitdw_geoSegmentBssEnd = ADDR(.vo_bitdw_geo.noload) + SIZEOF(.vo_bitdw_geo.noload); _vo_bitdw_geoSegmentBssSize = SIZEOF(.vo_bitdw_geo.noload); _vo_bitdw_mio0SegmentRomStart = _vo_bitdw_yay0SegmentRomStart; _vo_bitdw_mio0SegmentRomEnd = _vo_bitdw_yay0SegmentRomEnd;
   _vo_bitfs_yay0SegmentStart = ADDR(.vo_bitfs_yay0); _vo_bitfs_yay0SegmentRomStart = __romPos; .vo_bitfs_yay0 0x0e000000 : AT(__romPos) { KEEP(build/us_n64/actors/vanilla_actors/bitfs/data.szp.o(.data*)); . = ALIGN(0x10); } _vo_bitfs_yay0SegmentEnd = ADDR(.vo_bitfs_yay0) + SIZEOF(.vo_bitfs_yay0); _vo_bitfs_yay0SegmentRomEnd = __romPos + SIZEOF(.vo_bitfs_yay0); __romPos += SIZEOF(.vo_bitfs_yay0); _vo_bitfs_geoSegmentStart = ADDR(.vo_bitfs_geo); _vo_bitfs_geoSegmentRomStart = __romPos; .vo_bitfs_geo 0x1a000000 : AT(__romPos) { KEEP(build/us_n64/actors/vanilla_actors/bitfs/geo.o(.data*)); KEEP(build/us_n64/actors/vanilla_actors/bitfs/geo.o(.rodata*)); KEEP(build/us_n64/actors/vanilla_actors/bitfs/geo.o(.text*)); } _vo_bitfs_geoSegmentEnd = ADDR(.vo_bitfs_geo) + SIZEOF(.vo_bitfs_geo); _vo_bitfs_geoSegmentRomEnd = __romPos + SIZEOF(.vo_bitfs_geo); __romPos += SIZEOF(.vo_bitfs_geo); _vo_bitfs_geoSegmentBssStart = ADDR(.vo_bitfs_geo.noload); .vo_bitfs_geo.noload (NOLOAD) : { KEEP(build/us_n64/actors/vanilla_actors/bitfs/geo.o(.bss*)); } _vo_bitfs_geoSegmentBssEnd = ADDR(.vo_bitfs_geo.noload) + SIZEOF(.vo_bitfs_geo.noload); _vo_bitfs_geoSegmentBssSize = SIZEOF(.vo_bitfs_geo.noload); _vo_bitfs_mio0SegmentRomStart = _vo_bitfs_yay0SegmentRomStart; _vo_bitfs_mio0SegmentRomEnd = _vo_bitfs_yay0SegmentRomEnd;
   _vo_bits_yay0SegmentStart = ADDR(.vo_bits_yay0); _vo_bits_yay0SegmentRomStart = __romPos; .vo_bits_yay0 0x0e000000 : AT(__romPos) { KEEP(build/us_n64/actors/vanilla_actors/bits/data.szp.o(.data*)); . = ALIGN(0x10); } _vo_bits_yay0SegmentEnd = ADDR(.vo_bits_yay0) + SIZEOF(.vo_bits_yay0); _vo_bits_yay0SegmentRomEnd = __romPos + SIZEOF(.vo_bits_yay0); __romPos += SIZEOF(.vo_bits_yay0); _vo_bits_geoSegmentStart = ADDR(.vo_bits_geo); _vo_bits_geoSegmentRomStart = __romPos; .vo_bits_geo 0x1a000000 : AT(__romPos) { KEEP(build/us_n64/actors/vanilla_actors/bits/geo.o(.data*)); KEEP(build/us_n64/actors/vanilla_actors/bits/geo.o(.rodata*)); KEEP(build/us_n64/actors/vanilla_actors/bits/geo.o(.text*)); } _vo_bits_geoSegmentEnd = ADDR(.vo_bits_geo) + SIZEOF(.vo_bits_geo); _vo_bits_geoSegmentRomEnd = __romPos + SIZEOF(.vo_bits_geo); __romPos += SIZEOF(.vo_bits_geo); _vo_bits_geoSegmentBssStart = ADDR(.vo_bits_geo.noload); .vo_bits_geo.noload (NOLOAD) : { KEEP(build/us_n64/actors/vanilla_actors/bits/geo.o(.bss*)); } _vo_bits_geoSegmentBssEnd = ADDR(.vo_bits_geo.noload) + SIZEOF(.vo_bits_geo.noload); _vo_bits_geoSegmentBssSize = SIZEOF(.vo_bits_geo.noload); _vo_bits_mio0SegmentRomStart = _vo_bits_yay0SegmentRomStart; _vo_bits_mio0SegmentRomEnd = _vo_bits_yay0SegmentRomEnd;
   _vo_vcutm_yay0SegmentStart = ADDR(.vo_vcutm_yay0); _vo_vcutm_yay0SegmentRomStart = __romPos; .vo_vcutm_yay0 0x0e000000 : AT(__romPos) { KEEP(build/us_n64/actors/vanilla_actors/vcutm/data.szp.o(.data*)); . = ALIGN(0x10); } _vo_vcutm_yay0SegmentEnd = ADDR(.vo_vcutm_yay0) + SIZEOF(.vo_vcutm_yay0); _vo_vcutm_yay0SegmentRomEnd = __romPos + SIZEOF(.vo_vcutm_yay0); __romPos += SIZEOF(.vo_vcutm_yay0); _vo_vcutm_geoSegmentStart = ADDR(.vo_vcutm_geo); _vo_vcutm_geoSegmentRomStart = __romPos; .vo_vcutm_geo 0x1a000000 : AT(__romPos) { KEEP(build/us_n64/actors/vanilla_actors/vcutm/geo.o(.data*)); KEEP(build/us_n64/actors/vanilla_actors/vcutm/geo.o(.rodata*)); KEEP(build/us_n64/actors/vanilla_actors/vcutm/geo.o(.text*)); } _vo_vcutm_geoSegmentEnd = ADDR(.vo_vcutm_geo) + SIZEOF(.vo_vcutm_geo); _vo_vcutm_geoSegmentRomEnd = __romPos + SIZEOF(.vo_vcutm_geo); __romPos += SIZEOF(.vo_vcutm_geo); _vo_vcutm_geoSegmentBssStart = ADDR(.vo_vcutm_geo.noload); .vo_vcutm_geo.noload (NOLOAD) : { KEEP(build/us_n64/actors/vanilla_actors/vcutm/geo.o(.bss*)); } _vo_vcutm_geoSegmentBssEnd = ADDR(.vo_vcutm_geo.noload) + SIZEOF(.vo_vcutm_geo.noload); _vo_vcutm_geoSegmentBssSize = SIZEOF(.vo_vcutm_geo.noload); _vo_vcutm_mio0SegmentRomStart = _vo_vcutm_yay0SegmentRomStart; _vo_vcutm_mio0SegmentRomEnd = _vo_vcutm_yay0SegmentRomEnd;
   _vo_castle_inside_yay0SegmentStart = ADDR(.vo_castle_inside_yay0); _vo_castle_inside_yay0SegmentRomStart = __romPos; .vo_castle_inside_yay0 0x0e000000 : AT(__romPos) { KEEP(build/us_n64/actors/vanilla_actors/castle_inside/data.szp.o(.data*)); . = ALIGN(0x10); } _vo_castle_inside_yay0SegmentEnd = ADDR(.vo_castle_inside_yay0) + SIZEOF(.vo_castle_inside_yay0); _vo_castle_inside_yay0SegmentRomEnd = __romPos + SIZEOF(.vo_castle_inside_yay0); __romPos += SIZEOF(.vo_castle_inside_yay0); _vo_castle_inside_geoSegmentStart = ADDR(.vo_castle_inside_geo); _vo_castle_inside_geoSegmentRomStart = __romPos; .vo_castle_inside_geo 0x1a000000 : AT(__romPos) { KEEP(build/us_n64/actors/vanilla_actors/castle_inside/geo.o(.data*)); KEEP(build/us_n64/actors/vanilla_actors/castle_inside/geo.o(.rodata*)); KEEP(build/us_n64/actors/vanilla_actors/castle_inside/geo.o(.text*)); } _vo_castle_inside_geoSegmentEnd = ADDR(.vo_castle_inside_geo) + SIZEOF(.vo_castle_inside_geo); _vo_castle_inside_geoSegmentRomEnd = __romPos + SIZEOF(.vo_castle_inside_geo); __romPos += SIZEOF(.vo_castle_inside_geo); _vo_castle_inside_geoSegmentBssStart = ADDR(.vo_castle_inside_geo.noload); .vo_castle_inside_geo.noload (NOLOAD) : { KEEP(build/us_n64/actors/vanilla_actors/castle_inside/geo.o(.bss*)); } _vo_castle_inside_geoSegmentBssEnd = ADDR(.vo_castle_inside_geo.noload) + SIZEOF(.vo_castle_inside_geo.noload); _vo_castle_inside_geoSegmentBssSize = SIZEOF(.vo_castle_inside_geo.noload); _vo_castle_inside_mio0SegmentRomStart = _vo_castle_inside_yay0SegmentRomStart; _vo_castle_inside_mio0SegmentRomEnd = _vo_castle_inside_yay0SegmentRomEnd;
   _vo_castle_grounds_yay0SegmentStart = ADDR(.vo_castle_grounds_yay0); _vo_castle_grounds_yay0SegmentRomStart = __romPos; .vo_castle_grounds_yay0 0x0e000000 : AT(__romPos) { KEEP(build/us_n64/actors/vanilla_actors/castle_grounds/data.szp.o(.data*)); . = ALIGN(0x10); } _vo_castle_grounds_yay0SegmentEnd = ADDR(.vo_castle_grounds_yay0) + SIZEOF(.vo_castle_grounds_yay0); _vo_castle_grounds_yay0SegmentRomEnd = __romPos + SIZEOF(.vo_castle_grounds_yay0); __romPos += SIZEOF(.vo_castle_grounds_yay0); _vo_castle_grounds_geoSegmentStart = ADDR(.vo_castle_grounds_geo); _vo_castle_grounds_geoSegmentRomStart = __romPos; .vo_castle_grounds_geo 0x1a000000 : AT(__romPos) { KEEP(build/us_n64/actors/vanilla_actors/castle_grounds/geo.o(.data*)); KEEP(build/us_n64/actors/vanilla_actors/castle_grounds/geo.o(.rodata*)); KEEP(build/us_n64/actors/vanilla_actors/castle_grounds/geo.o(.text*)); } _vo_castle_grounds_geoSegmentEnd = ADDR(.vo_castle_grounds_geo) + SIZEOF(.vo_castle_grounds_geo); _vo_castle_grounds_geoSegmentRomEnd = __romPos + SIZEOF(.vo_castle_grounds_geo); __romPos += SIZEOF(.vo_castle_grounds_geo); _vo_castle_grounds_geoSegmentBssStart = ADDR(.vo_castle_grounds_geo.noload); .vo_castle_grounds_geo.noload (NOLOAD) : { KEEP(build/us_n64/actors/vanilla_actors/castle_grounds/geo.o(.bss*)); } _vo_castle_grounds_geoSegmentBssEnd = ADDR(.vo_castle_grounds_geo.noload) + SIZEOF(.vo_castle_grounds_geo.noload); _vo_castle_grounds_geoSegmentBssSize = SIZEOF(.vo_castle_grounds_geo.noload); _vo_castle_grounds_mio0SegmentRomStart = _vo_castle_grounds_yay0SegmentRomStart; _vo_castle_grounds_mio0SegmentRomEnd = _vo_castle_grounds_yay0SegmentRomEnd;
   _behaviorSegmentStart = ADDR(.behavior); _behaviorSegmentRomStart = __romPos; .behavior 0x13000000 : AT(__romPos)
   {
      KEEP(build/us_n64/data/behavior_data.o(.data*));
      KEEP(build/us_n64/data/behavior_data.o(.rodata*));
      KEEP(build/us_n64/data/behavior_data.o(.text*));
   }
   _behaviorSegmentEnd = ADDR(.behavior) + SIZEOF(.behavior); _behaviorSegmentRomEnd = __romPos + SIZEOF(.behavior); __romPos += SIZEOF(.behavior);
   _behaviorSegmentBssStart = ADDR(.behavior.noload); .behavior.noload (NOLOAD) :
   {
      KEEP(build/us_n64/data/behavior_data.o(.bss*));
   }
   _behaviorSegmentBssEnd = ADDR(.behavior.noload) + SIZEOF(.behavior.noload); _behaviorSegmentBssSize = SIZEOF(.behavior.noload);
   _goddardSegmentStart = ADDR(.goddard); _goddardSegmentRomStart = __romPos; .goddard ((0x80000000 + (0x00100000 * 8)) - GODDARD_SIZE) : AT(__romPos)
   {
      KEEP(build/us_n64/src/menu*.o(.text*));
      _goddardSegmentTextEnd = .;
      KEEP(build/us_n64/src/menu*.o(.data*));
      KEEP(build/us_n64/src/menu*.o(.rodata*));
      . = ALIGN(16);
   }
   _goddardSegmentEnd = ADDR(.goddard) + SIZEOF(.goddard); _goddardSegmentRomEnd = __romPos + SIZEOF(.goddard); __romPos += SIZEOF(.goddard);
   _goddardSegmentBssStart = ADDR(.goddard.noload); .goddard.noload (NOLOAD) :
   {
      KEEP(build/us_n64/src/menu*.o(.bss*));
      . = ALIGN(16);
   }
   _goddardSegmentBssEnd = ADDR(.goddard.noload) + SIZEOF(.goddard.noload); _goddardSegmentBssSize = SIZEOF(.goddard.noload);
   _introSegmentStart = ADDR(.intro); _introSegmentRomStart = __romPos; .intro 0x14000000 : AT(__romPos)
   {
      KEEP(build/us_n64/levels/intro/script.o(.data));
      KEEP(build/us_n64/levels/intro/script.o(.rodata*));
      KEEP(build/us_n64/levels/intro/script.o(.text*));
      KEEP(build/us_n64/levels/intro/geo.o(.data*));
   }
   _introSegmentEnd = ADDR(.intro) + SIZEOF(.intro); _introSegmentRomEnd = __romPos + SIZEOF(.intro); __romPos += SIZEOF(.intro);
   _introSegmentBssStart = ADDR(.intro.noload); .intro.noload (NOLOAD) :
   {
      KEEP(build/us_n64/levels/intro/script.o(.bss*));
   }
   _introSegmentBssEnd = ADDR(.intro.noload) + SIZEOF(.intro.noload); _introSegmentBssSize = SIZEOF(.intro.noload);
   _intro_segment_7SegmentStart = ADDR(.intro_segment_7); _intro_segment_7SegmentRomStart = __romPos; .intro_segment_7 0x07000000 : AT(__romPos)
   {
      KEEP(build/us_n64/levels/intro/leveldata.szp.o(.data*));
      . = ALIGN(0x10);
   }
   _intro_segment_7SegmentEnd = ADDR(.intro_segment_7) + SIZEOF(.intro_segment_7); _intro_segment_7SegmentRomEnd = __romPos + SIZEOF(.intro_segment_7); __romPos += SIZEOF(.intro_segment_7);
   _debug_level_select_yay0SegmentStart = ADDR(.debug_level_select_yay0); _debug_level_select_yay0SegmentRomStart = __romPos; .debug_level_select_yay0 0x07000000 : AT(__romPos) { KEEP(build/us_n64/bin/debug_level_select.szp.o(.data*)); KEEP(build/us_n64/bin/debug_level_select.szp.o(.rodata*)); . = ALIGN(0x10); } _debug_level_select_yay0SegmentEnd = ADDR(.debug_level_select_yay0) + SIZEOF(.debug_level_select_yay0); _debug_level_select_yay0SegmentRomEnd = __romPos + SIZEOF(.debug_level_select_yay0); __romPos += SIZEOF(.debug_level_select_yay0); _debug_level_select_mio0SegmentRomStart = _debug_level_select_yay0SegmentRomStart; _debug_level_select_mio0SegmentRomEnd = _debug_level_select_yay0SegmentRomEnd;
   _title_screen_bg_yay0SegmentStart = ADDR(.title_screen_bg_yay0); _title_screen_bg_yay0SegmentRomStart = __romPos; .title_screen_bg_yay0 0x0A000000 : AT(__romPos) { KEEP(build/us_n64/bin/title_screen_bg.szp.o(.data*)); KEEP(build/us_n64/bin/title_screen_bg.szp.o(.rodata*)); . = ALIGN(0x10); } _title_screen_bg_yay0SegmentEnd = ADDR(.title_screen_bg_yay0) + SIZEOF(.title_screen_bg_yay0); _title_screen_bg_yay0SegmentRomEnd = __romPos + SIZEOF(.title_screen_bg_yay0); __romPos += SIZEOF(.title_screen_bg_yay0); _title_screen_bg_mio0SegmentRomStart = _title_screen_bg_yay0SegmentRomStart; _title_screen_bg_mio0SegmentRomEnd = _title_screen_bg_yay0SegmentRomEnd;
   gMainLevels = __romPos;
   _menuSegmentStart = ADDR(.menu); _menuSegmentRomStart = __romPos; .menu 0x14000000 : AT(__romPos)
   {
      KEEP(build/us_n64/levels/menu/script.o(.data*));
      KEEP(build/us_n64/levels/menu/geo.o(.data*));
   }
   _menuSegmentEnd = ADDR(.menu) + SIZEOF(.menu); _menuSegmentRomEnd = __romPos + SIZEOF(.menu); __romPos += SIZEOF(.menu);
   _menu_segment_7SegmentStart = ADDR(.menu_segment_7); _menu_segment_7SegmentRomStart = __romPos; .menu_segment_7 0x07000000 : AT(__romPos)
   {
      KEEP(build/us_n64/levels/menu/leveldata.szp.o(.data*));
      . = ALIGN(0x10);
   }
   _menu_segment_7SegmentEnd = ADDR(.menu_segment_7) + SIZEOF(.menu_segment_7); _menu_segment_7SegmentRomEnd = __romPos + SIZEOF(.menu_segment_7); __romPos += SIZEOF(.menu_segment_7);
   _scriptsSegmentStart = ADDR(.scripts); _scriptsSegmentRomStart = __romPos; .scripts 0x15000000 : AT(__romPos)
   {
      build/us_n64/levels/scripts.o(.data*);
   }
   _scriptsSegmentEnd = ADDR(.scripts) + SIZEOF(.scripts); _scriptsSegmentRomEnd = __romPos + SIZEOF(.scripts); __romPos += SIZEOF(.scripts);
   _water_skybox_yay0SegmentStart = ADDR(.water_skybox_yay0); _water_skybox_yay0SegmentRomStart = __romPos; .water_skybox_yay0 0x0A000000 : AT(__romPos) { KEEP(build/us_n64/bin/water_skybox.szp.o(.data*)); KEEP(build/us_n64/bin/water_skybox.szp.o(.rodata*)); . = ALIGN(0x10); } _water_skybox_yay0SegmentEnd = ADDR(.water_skybox_yay0) + SIZEOF(.water_skybox_yay0); _water_skybox_yay0SegmentRomEnd = __romPos + SIZEOF(.water_skybox_yay0); __romPos += SIZEOF(.water_skybox_yay0); _water_skybox_mio0SegmentRomStart = _water_skybox_yay0SegmentRomStart; _water_skybox_mio0SegmentRomEnd = _water_skybox_yay0SegmentRomEnd;
   _ccm_skybox_yay0SegmentStart = ADDR(.ccm_skybox_yay0); _ccm_skybox_yay0SegmentRomStart = __romPos; .ccm_skybox_yay0 0x0A000000 : AT(__romPos) { KEEP(build/us_n64/bin/ccm_skybox.szp.o(.data*)); KEEP(build/us_n64/bin/ccm_skybox.szp.o(.rodata*)); . = ALIGN(0x10); } _ccm_skybox_yay0SegmentEnd = ADDR(.ccm_skybox_yay0) + SIZEOF(.ccm_skybox_yay0); _ccm_skybox_yay0SegmentRomEnd = __romPos + SIZEOF(.ccm_skybox_yay0); __romPos += SIZEOF(.ccm_skybox_yay0); _ccm_skybox_mio0SegmentRomStart = _ccm_skybox_yay0SegmentRomStart; _ccm_skybox_mio0SegmentRomEnd = _ccm_skybox_yay0SegmentRomEnd;
   _clouds_skybox_yay0SegmentStart = ADDR(.clouds_skybox_yay0); _clouds_skybox_yay0SegmentRomStart = __romPos; .clouds_skybox_yay0 0x0A000000 : AT(__romPos) { KEEP(build/us_n64/bin/clouds_skybox.szp.o(.data*)); KEEP(build/us_n64/bin/clouds_skybox.szp.o(.rodata*)); . = ALIGN(0x10); } _clouds_skybox_yay0SegmentEnd = ADDR(.clouds_skybox_yay0) + SIZEOF(.clouds_skybox_yay0); _clouds_skybox_yay0SegmentRomEnd = __romPos + SIZEOF(.clouds_skybox_yay0); __romPos += SIZEOF(.clouds_skybox_yay0); _clouds_skybox_mio0SegmentRomStart = _clouds_skybox_yay0SegmentRomStart; _clouds_skybox_mio0SegmentRomEnd = _clouds_skybox_yay0SegmentRomEnd;
   _bitfs_skybox_yay0SegmentStart = ADDR(.bitfs_skybox_yay0); _bitfs_skybox_yay0SegmentRomStart = __romPos; .bitfs_skybox_yay0 0x0A000000 : AT(__romPos) { KEEP(build/us_n64/bin/bitfs_skybox.szp.o(.data*)); KEEP(build/us_n64/bin/bitfs_skybox.szp.o(.rodata*)); . = ALIGN(0x10); } _bitfs_skybox_yay0SegmentEnd = ADDR(.bitfs_skybox_yay0) + SIZEOF(.bitfs_skybox_yay0); _bitfs_skybox_yay0SegmentRomEnd = __romPos + SIZEOF(.bitfs_skybox_yay0); __romPos += SIZEOF(.bitfs_skybox_yay0); _bitfs_skybox_mio0SegmentRomStart = _bitfs_skybox_yay0SegmentRomStart; _bitfs_skybox_mio0SegmentRomEnd = _bitfs_skybox_yay0SegmentRomEnd;
   _wdw_skybox_yay0SegmentStart = ADDR(.wdw_skybox_yay0); _wdw_skybox_yay0SegmentRomStart = __romPos; .wdw_skybox_yay0 0x0A000000 : AT(__romPos) { KEEP(build/us_n64/bin/wdw_skybox.szp.o(.data*)); KEEP(build/us_n64/bin/wdw_skybox.szp.o(.rodata*)); . = ALIGN(0x10); } _wdw_skybox_yay0SegmentEnd = ADDR(.wdw_skybox_yay0) + SIZEOF(.wdw_skybox_yay0); _wdw_skybox_yay0SegmentRomEnd = __romPos + SIZEOF(.wdw_skybox_yay0); __romPos += SIZEOF(.wdw_skybox_yay0); _wdw_skybox_mio0SegmentRomStart = _wdw_skybox_yay0SegmentRomStart; _wdw_skybox_mio0SegmentRomEnd = _wdw_skybox_yay0SegmentRomEnd;
   _cloud_floor_skybox_yay0SegmentStart = ADDR(.cloud_floor_skybox_yay0); _cloud_floor_skybox_yay0SegmentRomStart = __romPos; .cloud_floor_skybox_yay0 0x0A000000 : AT(__romPos) { KEEP(build/us_n64/bin/cloud_floor_skybox.szp.o(.data*)); KEEP(build/us_n64/bin/cloud_floor_skybox.szp.o(.rodata*)); . = ALIGN(0x10); } _cloud_floor_skybox_yay0SegmentEnd = ADDR(.cloud_floor_skybox_yay0) + SIZEOF(.cloud_floor_skybox_yay0); _cloud_floor_skybox_yay0SegmentRomEnd = __romPos + SIZEOF(.cloud_floor_skybox_yay0); __romPos += SIZEOF(.cloud_floor_skybox_yay0); _cloud_floor_skybox_mio0SegmentRomStart = _cloud_floor_skybox_yay0SegmentRomStart; _cloud_floor_skybox_mio0SegmentRomEnd = _cloud_floor_skybox_yay0SegmentRomEnd;
   _ssl_skybox_yay0SegmentStart = ADDR(.ssl_skybox_yay0); _ssl_skybox_yay0SegmentRomStart = __romPos; .ssl_skybox_yay0 0x0A000000 : AT(__romPos) { KEEP(build/us_n64/bin/ssl_skybox.szp.o(.data*)); KEEP(build/us_n64/bin/ssl_skybox.szp.o(.rodata*)); . = ALIGN(0x10); } _ssl_skybox_yay0SegmentEnd = ADDR(.ssl_skybox_yay0) + SIZEOF(.ssl_skybox_yay0); _ssl_skybox_yay0SegmentRomEnd = __romPos + SIZEOF(.ssl_skybox_yay0); __romPos += SIZEOF(.ssl_skybox_yay0); _ssl_skybox_mio0SegmentRomStart = _ssl_skybox_yay0SegmentRomStart; _ssl_skybox_mio0SegmentRomEnd = _ssl_skybox_yay0SegmentRomEnd;
   _bbh_skybox_yay0SegmentStart = ADDR(.bbh_skybox_yay0); _bbh_skybox_yay0SegmentRomStart = __romPos; .bbh_skybox_yay0 0x0A000000 : AT(__romPos) { KEEP(build/us_n64/bin/bbh_skybox.szp.o(.data*)); KEEP(build/us_n64/bin/bbh_skybox.szp.o(.rodata*)); . = ALIGN(0x10); } _bbh_skybox_yay0SegmentEnd = ADDR(.bbh_skybox_yay0) + SIZEOF(.bbh_skybox_yay0); _bbh_skybox_yay0SegmentRomEnd = __romPos + SIZEOF(.bbh_skybox_yay0); __romPos += SIZEOF(.bbh_skybox_yay0); _bbh_skybox_mio0SegmentRomStart = _bbh_skybox_yay0SegmentRomStart; _bbh_skybox_mio0SegmentRomEnd = _bbh_skybox_yay0SegmentRomEnd;
   _bidw_skybox_yay0SegmentStart = ADDR(.bidw_skybox_yay0); _bidw_skybox_yay0SegmentRomStart = __romPos; .bidw_skybox_yay0 0x0A000000 : AT(__romPos) { KEEP(build/us_n64/bin/bidw_skybox.szp.o(.data*)); KEEP(build/us_n64/bin/bidw_skybox.szp.o(.rodata*)); . = ALIGN(0x10); } _bidw_skybox_yay0SegmentEnd = ADDR(.bidw_skybox_yay0) + SIZEOF(.bidw_skybox_yay0); _bidw_skybox_yay0SegmentRomEnd = __romPos + SIZEOF(.bidw_skybox_yay0); __romPos += SIZEOF(.bidw_skybox_yay0); _bidw_skybox_mio0SegmentRomStart = _bidw_skybox_yay0SegmentRomStart; _bidw_skybox_mio0SegmentRomEnd = _bidw_skybox_yay0SegmentRomEnd;
   _bits_skybox_yay0SegmentStart = ADDR(.bits_skybox_yay0); _bits_skybox_yay0SegmentRomStart = __romPos; .bits_skybox_yay0 0x0A000000 : AT(__romPos) { KEEP(build/us_n64/bin/bits_skybox.szp.o(.data*)); KEEP(build/us_n64/bin/bits_skybox.szp.o(.rodata*)); . = ALIGN(0x10); } _bits_skybox_yay0SegmentEnd = ADDR(.bits_skybox_yay0) + SIZEOF(.bits_skybox_yay0); _bits_skybox_yay0SegmentRomEnd = __romPos + SIZEOF(.bits_skybox_yay0); __romPos += SIZEOF(.bits_skybox_yay0); _bits_skybox_mio0SegmentRomStart = _bits_skybox_yay0SegmentRomStart; _bits_skybox_mio0SegmentRomEnd = _bits_skybox_yay0SegmentRomEnd;
   _fire_yay0SegmentStart = ADDR(.fire_yay0); _fire_yay0SegmentRomStart = __romPos; .fire_yay0 0x09000000 : AT(__romPos) { KEEP(build/us_n64/bin/fire.szp.o(.data*)); KEEP(build/us_n64/bin/fire.szp.o(.rodata*)); . = ALIGN(0x10); } _fire_yay0SegmentEnd = ADDR(.fire_yay0) + SIZEOF(.fire_yay0); _fire_yay0SegmentRomEnd = __romPos + SIZEOF(.fire_yay0); __romPos += SIZEOF(.fire_yay0); _fire_mio0SegmentRomStart = _fire_yay0SegmentRomStart; _fire_mio0SegmentRomEnd = _fire_yay0SegmentRomEnd;
   _spooky_yay0SegmentStart = ADDR(.spooky_yay0); _spooky_yay0SegmentRomStart = __romPos; .spooky_yay0 0x09000000 : AT(__romPos) { KEEP(build/us_n64/bin/spooky.szp.o(.data*)); KEEP(build/us_n64/bin/spooky.szp.o(.rodata*)); . = ALIGN(0x10); } _spooky_yay0SegmentEnd = ADDR(.spooky_yay0) + SIZEOF(.spooky_yay0); _spooky_yay0SegmentRomEnd = __romPos + SIZEOF(.spooky_yay0); __romPos += SIZEOF(.spooky_yay0); _spooky_mio0SegmentRomStart = _spooky_yay0SegmentRomStart; _spooky_mio0SegmentRomEnd = _spooky_yay0SegmentRomEnd;
   _generic_yay0SegmentStart = ADDR(.generic_yay0); _generic_yay0SegmentRomStart = __romPos; .generic_yay0 0x09000000 : AT(__romPos) { KEEP(build/us_n64/bin/generic.szp.o(.data*)); KEEP(build/us_n64/bin/generic.szp.o(.rodata*)); . = ALIGN(0x10); } _generic_yay0SegmentEnd = ADDR(.generic_yay0) + SIZEOF(.generic_yay0); _generic_yay0SegmentRomEnd = __romPos + SIZEOF(.generic_yay0); __romPos += SIZEOF(.generic_yay0); _generic_mio0SegmentRomStart = _generic_yay0SegmentRomStart; _generic_mio0SegmentRomEnd = _generic_yay0SegmentRomEnd;
   _water_yay0SegmentStart = ADDR(.water_yay0); _water_yay0SegmentRomStart = __romPos; .water_yay0 0x09000000 : AT(__romPos) { KEEP(build/us_n64/bin/water.szp.o(.data*)); KEEP(build/us_n64/bin/water.szp.o(.rodata*)); . = ALIGN(0x10); } _water_yay0SegmentEnd = ADDR(.water_yay0) + SIZEOF(.water_yay0); _water_yay0SegmentRomEnd = __romPos + SIZEOF(.water_yay0); __romPos += SIZEOF(.water_yay0); _water_mio0SegmentRomStart = _water_yay0SegmentRomStart; _water_mio0SegmentRomEnd = _water_yay0SegmentRomEnd;
   _sky_yay0SegmentStart = ADDR(.sky_yay0); _sky_yay0SegmentRomStart = __romPos; .sky_yay0 0x09000000 : AT(__romPos) { KEEP(build/us_n64/bin/sky.szp.o(.data*)); KEEP(build/us_n64/bin/sky.szp.o(.rodata*)); . = ALIGN(0x10); } _sky_yay0SegmentEnd = ADDR(.sky_yay0) + SIZEOF(.sky_yay0); _sky_yay0SegmentRomEnd = __romPos + SIZEOF(.sky_yay0); __romPos += SIZEOF(.sky_yay0); _sky_mio0SegmentRomStart = _sky_yay0SegmentRomStart; _sky_mio0SegmentRomEnd = _sky_yay0SegmentRomEnd;
   _snow_yay0SegmentStart = ADDR(.snow_yay0); _snow_yay0SegmentRomStart = __romPos; .snow_yay0 0x09000000 : AT(__romPos) { KEEP(build/us_n64/bin/snow.szp.o(.data*)); KEEP(build/us_n64/bin/snow.szp.o(.rodata*)); . = ALIGN(0x10); } _snow_yay0SegmentEnd = ADDR(.snow_yay0) + SIZEOF(.snow_yay0); _snow_yay0SegmentRomEnd = __romPos + SIZEOF(.snow_yay0); __romPos += SIZEOF(.snow_yay0); _snow_mio0SegmentRomStart = _snow_yay0SegmentRomStart; _snow_mio0SegmentRomEnd = _snow_yay0SegmentRomEnd;
   _cave_yay0SegmentStart = ADDR(.cave_yay0); _cave_yay0SegmentRomStart = __romPos; .cave_yay0 0x09000000 : AT(__romPos) { KEEP(build/us_n64/bin/cave.szp.o(.data*)); KEEP(build/us_n64/bin/cave.szp.o(.rodata*)); . = ALIGN(0x10); } _cave_yay0SegmentEnd = ADDR(.cave_yay0) + SIZEOF(.cave_yay0); _cave_yay0SegmentRomEnd = __romPos + SIZEOF(.cave_yay0); __romPos += SIZEOF(.cave_yay0); _cave_mio0SegmentRomStart = _cave_yay0SegmentRomStart; _cave_mio0SegmentRomEnd = _cave_yay0SegmentRomEnd;
   _machine_yay0SegmentStart = ADDR(.machine_yay0); _machine_yay0SegmentRomStart = __romPos; .machine_yay0 0x09000000 : AT(__romPos) { KEEP(build/us_n64/bin/machine.szp.o(.data*)); KEEP(build/us_n64/bin/machine.szp.o(.rodata*)); . = ALIGN(0x10); } _machine_yay0SegmentEnd = ADDR(.machine_yay0) + SIZEOF(.machine_yay0); _machine_yay0SegmentRomEnd = __romPos + SIZEOF(.machine_yay0); __romPos += SIZEOF(.machine_yay0); _machine_mio0SegmentRomStart = _machine_yay0SegmentRomStart; _machine_mio0SegmentRomEnd = _machine_yay0SegmentRomEnd;
   _mountain_yay0SegmentStart = ADDR(.mountain_yay0); _mountain_yay0SegmentRomStart = __romPos; .mountain_yay0 0x09000000 : AT(__romPos) { KEEP(build/us_n64/bin/mountain.szp.o(.data*)); KEEP(build/us_n64/bin/mountain.szp.o(.rodata*)); . = ALIGN(0x10); } _mountain_yay0SegmentEnd = ADDR(.mountain_yay0) + SIZEOF(.mountain_yay0); _mountain_yay0SegmentRomEnd = __romPos + SIZEOF(.mountain_yay0); __romPos += SIZEOF(.mountain_yay0); _mountain_mio0SegmentRomStart = _mountain_yay0SegmentRomStart; _mountain_mio0SegmentRomEnd = _mountain_yay0SegmentRomEnd;
   _grass_yay0SegmentStart = ADDR(.grass_yay0); _grass_yay0SegmentRomStart = __romPos; .grass_yay0 0x09000000 : AT(__romPos) { KEEP(build/us_n64/bin/grass.szp.o(.data*)); KEEP(build/us_n64/bin/grass.szp.o(.rodata*)); . = ALIGN(0x10); } _grass_yay0SegmentEnd = ADDR(.grass_yay0) + SIZEOF(.grass_yay0); _grass_yay0SegmentRomEnd = __romPos + SIZEOF(.grass_yay0); __romPos += SIZEOF(.grass_yay0); _grass_mio0SegmentRomStart = _grass_yay0SegmentRomStart; _grass_mio0SegmentRomEnd = _grass_yay0SegmentRomEnd;
   _outside_yay0SegmentStart = ADDR(.outside_yay0); _outside_yay0SegmentRomStart = __romPos; .outside_yay0 0x09000000 : AT(__romPos) { KEEP(build/us_n64/bin/outside.szp.o(.data*)); KEEP(build/us_n64/bin/outside.szp.o(.rodata*)); . = ALIGN(0x10); } _outside_yay0SegmentEnd = ADDR(.outside_yay0) + SIZEOF(.outside_yay0); _outside_yay0SegmentRomEnd = __romPos + SIZEOF(.outside_yay0); __romPos += SIZEOF(.outside_yay0); _outside_mio0SegmentRomStart = _outside_yay0SegmentRomStart; _outside_mio0SegmentRomEnd = _outside_yay0SegmentRomEnd;
   _inside_yay0SegmentStart = ADDR(.inside_yay0); _inside_yay0SegmentRomStart = __romPos; .inside_yay0 0x09000000 : AT(__romPos) { KEEP(build/us_n64/bin/inside.szp.o(.data*)); KEEP(build/us_n64/bin/inside.szp.o(.rodata*)); . = ALIGN(0x10); } _inside_yay0SegmentEnd = ADDR(.inside_yay0) + SIZEOF(.inside_yay0); _inside_yay0SegmentRomEnd = __romPos + SIZEOF(.inside_yay0); __romPos += SIZEOF(.inside_yay0); _inside_mio0SegmentRomStart = _inside_yay0SegmentRomStart; _inside_mio0SegmentRomEnd = _inside_yay0SegmentRomEnd;
   _effect_yay0SegmentStart = ADDR(.effect_yay0); _effect_yay0SegmentRomStart = __romPos; .effect_yay0 0x0B000000 : AT(__romPos) { KEEP(build/us_n64/bin/effect.szp.o(.data*)); KEEP(build/us_n64/bin/effect.szp.o(.rodata*)); . = ALIGN(0x10); } _effect_yay0SegmentEnd = ADDR(.effect_yay0) + SIZEOF(.effect_yay0); _effect_yay0SegmentRomEnd = __romPos + SIZEOF(.effect_yay0); __romPos += SIZEOF(.effect_yay0); _effect_mio0SegmentRomStart = _effect_yay0SegmentRomStart; _effect_mio0SegmentRomEnd = _effect_yay0SegmentRomEnd;



_bbh_segment_7SegmentStart = ADDR(.bbh_segment_7); _bbh_segment_7SegmentRomStart = __romPos; .bbh_segment_7 0x07000000 : AT(__romPos) { KEEP(build/us_n64/levels/bbh/leveldata.szp.o(.data*)); . = ALIGN(0x10); } _bbh_segment_7SegmentEnd = ADDR(.bbh_segment_7) + SIZEOF(.bbh_segment_7); _bbh_segment_7SegmentRomEnd = __romPos + SIZEOF(.bbh_segment_7); __romPos += SIZEOF(.bbh_segment_7); _bbhSegmentStart = ADDR(.bbh); _bbhSegmentRomStart = __romPos; .bbh 0x19000000 : AT(__romPos) { KEEP(build/us_n64/levels/bbh/script.o(.data*)); KEEP(build/us_n64/levels/bbh/script.o(.text*)); KEEP(build/us_n64/levels/bbh/script.o(.rodata*)); KEEP(build/us_n64/levels/bbh/geo.o(.data*)); KEEP(build/us_n64/levels/bbh/geo.o(.text*)); KEEP(build/us_n64/levels/bbh/geo.o(.rodata*)); } _bbhSegmentEnd = ADDR(.bbh) + SIZEOF(.bbh); _bbhSegmentRomEnd = __romPos + SIZEOF(.bbh); __romPos += SIZEOF(.bbh); _bbhSegmentBssStart = ADDR(.bbh.noload); .bbh.noload (NOLOAD) : { KEEP(build/us_n64/levels/bbh/script.o(.bss*)); KEEP(build/us_n64/levels/bbh/geo.o(.bss*)); } _bbhSegmentBssEnd = ADDR(.bbh.noload) + SIZEOF(.bbh.noload); _bbhSegmentBssSize = SIZEOF(.bbh.noload);
_ccm_segment_7SegmentStart = ADDR(.ccm_segment_7); _ccm_segment_7SegmentRomStart = __romPos; .ccm_segment_7 0x07000000 : AT(__romPos) { KEEP(build/us_n64/levels/ccm/leveldata.szp.o(.data*)); . = ALIGN(0x10); } _ccm_segment_7SegmentEnd = ADDR(.ccm_segment_7) + SIZEOF(.ccm_segment_7); _ccm_segment_7SegmentRomEnd = __romPos + SIZEOF(.ccm_segment_7); __romPos += SIZEOF(.ccm_segment_7); _ccmSegmentStart = ADDR(.ccm); _ccmSegmentRomStart = __romPos; .ccm 0x19000000 : AT(__romPos) { KEEP(build/us_n64/levels/ccm/script.o(.data*)); KEEP(build/us_n64/levels/ccm/script.o(.text*)); KEEP(build/us_n64/levels/ccm/script.o(.rodata*)); KEEP(build/us_n64/levels/ccm/geo.o(.data*)); KEEP(build/us_n64/levels/ccm/geo.o(.text*)); KEEP(build/us_n64/levels/ccm/geo.o(.rodata*)); } _ccmSegmentEnd = ADDR(.ccm) + SIZEOF(.ccm); _ccmSegmentRomEnd = __romPos + SIZEOF(.ccm); __romPos += SIZEOF(.ccm); _ccmSegmentBssStart = ADDR(.ccm.noload); .ccm.noload (NOLOAD) : { KEEP(build/us_n64/levels/ccm/script.o(.bss*)); KEEP(build/us_n64/levels/ccm/geo.o(.bss*)); } _ccmSegmentBssEnd = ADDR(.ccm.noload) + SIZEOF(.ccm.noload); _ccmSegmentBssSize = SIZEOF(.ccm.noload);
_castle_inside_segment_7SegmentStart = ADDR(.castle_inside_segment_7); _castle_inside_segment_7SegmentRomStart = __romPos; .castle_inside_segment_7 0x07000000 : AT(__romPos) { KEEP(build/us_n64/levels/castle_inside/leveldata.szp.o(.data*)); . = ALIGN(0x10); } _castle_inside_segment_7SegmentEnd = ADDR(.castle_inside_segment_7) + SIZEOF(.castle_inside_segment_7); _castle_inside_segment_7SegmentRomEnd = __romPos + SIZEOF(.castle_inside_segment_7); __romPos += SIZEOF(.castle_inside_segment_7); _castle_insideSegmentStart = ADDR(.castle_inside); _castle_insideSegmentRomStart = __romPos; .castle_inside 0x19000000 : AT(__romPos) { KEEP(build/us_n64/levels/castle_inside/script.o(.data*)); KEEP(build/us_n64/levels/castle_inside/script.o(.text*)); KEEP(build/us_n64/levels/castle_inside/script.o(.rodata*)); KEEP(build/us_n64/levels/castle_inside/geo.o(.data*)); KEEP(build/us_n64/levels/castle_inside/geo.o(.text*)); KEEP(build/us_n64/levels/castle_inside/geo.o(.rodata*)); } _castle_insideSegmentEnd = ADDR(.castle_inside) + SIZEOF(.castle_inside); _castle_insideSegmentRomEnd = __romPos + SIZEOF(.castle_inside); __romPos += SIZEOF(.castle_inside); _castle_insideSegmentBssStart = ADDR(.castle_inside.noload); .castle_inside.noload (NOLOAD) : { KEEP(build/us_n64/levels/castle_inside/script.o(.bss*)); KEEP(build/us_n64/levels/castle_inside/geo.o(.bss*)); } _castle_insideSegmentBssEnd = ADDR(.castle_inside.noload) + SIZEOF(.castle_inside.noload); _castle_insideSegmentBssSize = SIZEOF(.castle_inside.noload);
_hmc_segment_7SegmentStart = ADDR(.hmc_segment_7); _hmc_segment_7SegmentRomStart = __romPos; .hmc_segment_7 0x07000000 : AT(__romPos) { KEEP(build/us_n64/levels/hmc/leveldata.szp.o(.data*)); . = ALIGN(0x10); } _hmc_segment_7SegmentEnd = ADDR(.hmc_segment_7) + SIZEOF(.hmc_segment_7); _hmc_segment_7SegmentRomEnd = __romPos + SIZEOF(.hmc_segment_7); __romPos += SIZEOF(.hmc_segment_7); _hmcSegmentStart = ADDR(.hmc); _hmcSegmentRomStart = __romPos; .hmc 0x19000000 : AT(__romPos) { KEEP(build/us_n64/levels/hmc/script.o(.data*)); KEEP(build/us_n64/levels/hmc/script.o(.text*)); KEEP(build/us_n64/levels/hmc/script.o(.rodata*)); KEEP(build/us_n64/levels/hmc/geo.o(.data*)); KEEP(build/us_n64/levels/hmc/geo.o(.text*)); KEEP(build/us_n64/levels/hmc/geo.o(.rodata*)); } _hmcSegmentEnd = ADDR(.hmc) + SIZEOF(.hmc); _hmcSegmentRomEnd = __romPos + SIZEOF(.hmc); __romPos += SIZEOF(.hmc); _hmcSegmentBssStart = ADDR(.hmc.noload); .hmc.noload (NOLOAD) : { KEEP(build/us_n64/levels/hmc/script.o(.bss*)); KEEP(build/us_n64/levels/hmc/geo.o(.bss*)); } _hmcSegmentBssEnd = ADDR(.hmc.noload) + SIZEOF(.hmc.noload); _hmcSegmentBssSize = SIZEOF(.hmc.noload);
_ssl_segment_7SegmentStart = ADDR(.ssl_segment_7); _ssl_segment_7SegmentRomStart = __romPos; .ssl_segment_7 0x07000000 : AT(__romPos) { KEEP(build/us_n64/levels/ssl/leveldata.szp.o(.data*)); . = ALIGN(0x10); } _ssl_segment_7SegmentEnd = ADDR(.ssl_segment_7) + SIZEOF(.ssl_segment_7); _ssl_segment_7SegmentRomEnd = __romPos + SIZEOF(.ssl_segment_7); __romPos += SIZEOF(.ssl_segment_7); _sslSegmentStart = ADDR(.ssl); _sslSegmentRomStart = __romPos; .ssl 0x19000000 : AT(__romPos) { KEEP(build/us_n64/levels/ssl/script.o(.data*)); KEEP(build/us_n64/levels/ssl/script.o(.text*)); KEEP(build/us_n64/levels/ssl/script.o(.rodata*)); KEEP(build/us_n64/levels/ssl/geo.o(.data*)); KEEP(build/us_n64/levels/ssl/geo.o(.text*)); KEEP(build/us_n64/levels/ssl/geo.o(.rodata*)); } _sslSegmentEnd = ADDR(.ssl) + SIZEOF(.ssl); _sslSegmentRomEnd = __romPos + SIZEOF(.ssl); __romPos += SIZEOF(.ssl); _sslSegmentBssStart = ADDR(.ssl.noload); .ssl.noload (NOLOAD) : { KEEP(build/us_n64/levels/ssl/script.o(.bss*)); KEEP(build/us_n64/levels/ssl/geo.o(.bss*)); } _sslSegmentBssEnd = ADDR(.ssl.noload) + SIZEOF(.ssl.noload); _sslSegmentBssSize = SIZEOF(.ssl.noload);
_bob_segment_7SegmentStart = ADDR(.bob_segment_7); _bob_segment_7SegmentRomStart = __romPos; .bob_segment_7 0x07000000 : AT(__romPos) { KEEP(build/us_n64/levels/bob/leveldata.szp.o(.data*)); . = ALIGN(0x10); } _bob_segment_7SegmentEnd = ADDR(.bob_segment_7) + SIZEOF(.bob_segment_7); _bob_segment_7SegmentRomEnd = __romPos + SIZEOF(.bob_segment_7); __romPos += SIZEOF(.bob_segment_7); _bobSegmentStart = ADDR(.bob); _bobSegmentRomStart = __romPos; .bob 0x19000000 : AT(__romPos) { KEEP(build/us_n64/levels/bob/script.o(.data*)); KEEP(build/us_n64/levels/bob/script.o(.text*)); KEEP(build/us_n64/levels/bob/script.o(.rodata*)); KEEP(build/us_n64/levels/bob/geo.o(.data*)); KEEP(build/us_n64/levels/bob/geo.o(.text*)); KEEP(build/us_n64/levels/bob/geo.o(.rodata*)); } _bobSegmentEnd = ADDR(.bob) + SIZEOF(.bob); _bobSegmentRomEnd = __romPos + SIZEOF(.bob); __romPos += SIZEOF(.bob); _bobSegmentBssStart = ADDR(.bob.noload); .bob.noload (NOLOAD) : { KEEP(build/us_n64/levels/bob/script.o(.bss*)); KEEP(build/us_n64/levels/bob/geo.o(.bss*)); } _bobSegmentBssEnd = ADDR(.bob.noload) + SIZEOF(.bob.noload); _bobSegmentBssSize = SIZEOF(.bob.noload);
_sl_segment_7SegmentStart = ADDR(.sl_segment_7); _sl_segment_7SegmentRomStart = __romPos; .sl_segment_7 0x07000000 : AT(__romPos) { KEEP(build/us_n64/levels/sl/leveldata.szp.o(.data*)); . = ALIGN(0x10); } _sl_segment_7SegmentEnd = ADDR(.sl_segment_7) + SIZEOF(.sl_segment_7); _sl_segment_7SegmentRomEnd = __romPos + SIZEOF(.sl_segment_7); __romPos += SIZEOF(.sl_segment_7); _slSegmentStart = ADDR(.sl); _slSegmentRomStart = __romPos; .sl 0x19000000 : AT(__romPos) { KEEP(build/us_n64/levels/sl/script.o(.data*)); KEEP(build/us_n64/levels/sl/script.o(.text*)); KEEP(build/us_n64/levels/sl/script.o(.rodata*)); KEEP(build/us_n64/levels/sl/geo.o(.data*)); KEEP(build/us_n64/levels/sl/geo.o(.text*)); KEEP(build/us_n64/levels/sl/geo.o(.rodata*)); } _slSegmentEnd = ADDR(.sl) + SIZEOF(.sl); _slSegmentRomEnd = __romPos + SIZEOF(.sl); __romPos += SIZEOF(.sl); _slSegmentBssStart = ADDR(.sl.noload); .sl.noload (NOLOAD) : { KEEP(build/us_n64/levels/sl/script.o(.bss*)); KEEP(build/us_n64/levels/sl/geo.o(.bss*)); } _slSegmentBssEnd = ADDR(.sl.noload) + SIZEOF(.sl.noload); _slSegmentBssSize = SIZEOF(.sl.noload);
_wdw_segment_7SegmentStart = ADDR(.wdw_segment_7); _wdw_segment_7SegmentRomStart = __romPos; .wdw_segment_7 0x07000000 : AT(__romPos) { KEEP(build/us_n64/levels/wdw/leveldata.szp.o(.data*)); . = ALIGN(0x10); } _wdw_segment_7SegmentEnd = ADDR(.wdw_segment_7) + SIZEOF(.wdw_segment_7); _wdw_segment_7SegmentRomEnd = __romPos + SIZEOF(.wdw_segment_7); __romPos += SIZEOF(.wdw_segment_7); _wdwSegmentStart = ADDR(.wdw); _wdwSegmentRomStart = __romPos; .wdw 0x19000000 : AT(__romPos) { KEEP(build/us_n64/levels/wdw/script.o(.data*)); KEEP(build/us_n64/levels/wdw/script.o(.text*)); KEEP(build/us_n64/levels/wdw/script.o(.rodata*)); KEEP(build/us_n64/levels/wdw/geo.o(.data*)); KEEP(build/us_n64/levels/wdw/geo.o(.text*)); KEEP(build/us_n64/levels/wdw/geo.o(.rodata*)); } _wdwSegmentEnd = ADDR(.wdw) + SIZEOF(.wdw); _wdwSegmentRomEnd = __romPos + SIZEOF(.wdw); __romPos += SIZEOF(.wdw); _wdwSegmentBssStart = ADDR(.wdw.noload); .wdw.noload (NOLOAD) : { KEEP(build/us_n64/levels/wdw/script.o(.bss*)); KEEP(build/us_n64/levels/wdw/geo.o(.bss*)); } _wdwSegmentBssEnd = ADDR(.wdw.noload) + SIZEOF(.wdw.noload); _wdwSegmentBssSize = SIZEOF(.wdw.noload);
_jrb_segment_7SegmentStart = ADDR(.jrb_segment_7); _jrb_segment_7SegmentRomStart = __romPos; .jrb_segment_7 0x07000000 : AT(__romPos) { KEEP(build/us_n64/levels/jrb/leveldata.szp.o(.data*)); . = ALIGN(0x10); } _jrb_segment_7SegmentEnd = ADDR(.jrb_segment_7) + SIZEOF(.jrb_segment_7); _jrb_segment_7SegmentRomEnd = __romPos + SIZEOF(.jrb_segment_7); __romPos += SIZEOF(.jrb_segment_7); _jrbSegmentStart = ADDR(.jrb); _jrbSegmentRomStart = __romPos; .jrb 0x19000000 : AT(__romPos) { KEEP(build/us_n64/levels/jrb/script.o(.data*)); KEEP(build/us_n64/levels/jrb/script.o(.text*)); KEEP(build/us_n64/levels/jrb/script.o(.rodata*)); KEEP(build/us_n64/levels/jrb/geo.o(.data*)); KEEP(build/us_n64/levels/jrb/geo.o(.text*)); KEEP(build/us_n64/levels/jrb/geo.o(.rodata*)); } _jrbSegmentEnd = ADDR(.jrb) + SIZEOF(.jrb); _jrbSegmentRomEnd = __romPos + SIZEOF(.jrb); __romPos += SIZEOF(.jrb); _jrbSegmentBssStart = ADDR(.jrb.noload); .jrb.noload (NOLOAD) : { KEEP(build/us_n64/levels/jrb/script.o(.bss*)); KEEP(build/us_n64/levels/jrb/geo.o(.bss*)); } _jrbSegmentBssEnd = ADDR(.jrb.noload) + SIZEOF(.jrb.noload); _jrbSegmentBssSize = SIZEOF(.jrb.noload);
_thi_segment_7SegmentStart = ADDR(.thi_segment_7); _thi_segment_7SegmentRomStart = __romPos; .thi_segment_7 0x07000000 : AT(__romPos) { KEEP(build/us_n64/levels/thi/leveldata.szp.o(.data*)); . = ALIGN(0x10); } _thi_segment_7SegmentEnd = ADDR(.thi_segment_7) + SIZEOF(.thi_segment_7); _thi_segment_7SegmentRomEnd = __romPos + SIZEOF(.thi_segment_7); __romPos += SIZEOF(.thi_segment_7); _thiSegmentStart = ADDR(.thi); _thiSegmentRomStart = __romPos; .thi 0x19000000 : AT(__romPos) { KEEP(build/us_n64/levels/thi/script.o(.data*)); KEEP(build/us_n64/levels/thi/script.o(.text*)); KEEP(build/us_n64/levels/thi/script.o(.rodata*)); KEEP(build/us_n64/levels/thi/geo.o(.data*)); KEEP(build/us_n64/levels/thi/geo.o(.text*)); KEEP(build/us_n64/levels/thi/geo.o(.rodata*)); } _thiSegmentEnd = ADDR(.thi) + SIZEOF(.thi); _thiSegmentRomEnd = __romPos + SIZEOF(.thi); __romPos += SIZEOF(.thi); _thiSegmentBssStart = ADDR(.thi.noload); .thi.noload (NOLOAD) : { KEEP(build/us_n64/levels/thi/script.o(.bss*)); KEEP(build/us_n64/levels/thi/geo.o(.bss*)); } _thiSegmentBssEnd = ADDR(.thi.noload) + SIZEOF(.thi.noload); _thiSegmentBssSize = SIZEOF(.thi.noload);
_ttc_segment_7SegmentStart = ADDR(.ttc_segment_7); _ttc_segment_7SegmentRomStart = __romPos; .ttc_segment_7 0x07000000 : AT(__romPos) { KEEP(build/us_n64/levels/ttc/leveldata.szp.o(.data*)); . = ALIGN(0x10); } _ttc_segment_7SegmentEnd = ADDR(.ttc_segment_7) + SIZEOF(.ttc_segment_7); _ttc_segment_7SegmentRomEnd = __romPos + SIZEOF(.ttc_segment_7); __romPos += SIZEOF(.ttc_segment_7); _ttcSegmentStart = ADDR(.ttc); _ttcSegmentRomStart = __romPos; .ttc 0x19000000 : AT(__romPos) { KEEP(build/us_n64/levels/ttc/script.o(.data*)); KEEP(build/us_n64/levels/ttc/script.o(.text*)); KEEP(build/us_n64/levels/ttc/script.o(.rodata*)); KEEP(build/us_n64/levels/ttc/geo.o(.data*)); KEEP(build/us_n64/levels/ttc/geo.o(.text*)); KEEP(build/us_n64/levels/ttc/geo.o(.rodata*)); } _ttcSegmentEnd = ADDR(.ttc) + SIZEOF(.ttc); _ttcSegmentRomEnd = __romPos + SIZEOF(.ttc); __romPos += SIZEOF(.ttc); _ttcSegmentBssStart = ADDR(.ttc.noload); .ttc.noload (NOLOAD) : { KEEP(build/us_n64/levels/ttc/script.o(.bss*)); KEEP(build/us_n64/levels/ttc/geo.o(.bss*)); } _ttcSegmentBssEnd = ADDR(.ttc.noload) + SIZEOF(.ttc.noload); _ttcSegmentBssSize = SIZEOF(.ttc.noload);
_rr_segment_7SegmentStart = ADDR(.rr_segment_7); _rr_segment_7SegmentRomStart = __romPos; .rr_segment_7 0x07000000 : AT(__romPos) { KEEP(build/us_n64/levels/rr/leveldata.szp.o(.data*)); . = ALIGN(0x10); } _rr_segment_7SegmentEnd = ADDR(.rr_segment_7) + SIZEOF(.rr_segment_7); _rr_segment_7SegmentRomEnd = __romPos + SIZEOF(.rr_segment_7); __romPos += SIZEOF(.rr_segment_7); _rrSegmentStart = ADDR(.rr); _rrSegmentRomStart = __romPos; .rr 0x19000000 : AT(__romPos) { KEEP(build/us_n64/levels/rr/script.o(.data*)); KEEP(build/us_n64/levels/rr/script.o(.text*)); KEEP(build/us_n64/levels/rr/script.o(.rodata*)); KEEP(build/us_n64/levels/rr/geo.o(.data*)); KEEP(build/us_n64/levels/rr/geo.o(.text*)); KEEP(build/us_n64/levels/rr/geo.o(.rodata*)); } _rrSegmentEnd = ADDR(.rr) + SIZEOF(.rr); _rrSegmentRomEnd = __romPos + SIZEOF(.rr); __romPos += SIZEOF(.rr); _rrSegmentBssStart = ADDR(.rr.noload); .rr.noload (NOLOAD) : { KEEP(build/us_n64/levels/rr/script.o(.bss*)); KEEP(build/us_n64/levels/rr/geo.o(.bss*)); } _rrSegmentBssEnd = ADDR(.rr.noload) + SIZEOF(.rr.noload); _rrSegmentBssSize = SIZEOF(.rr.noload);
_castle_grounds_segment_7SegmentStart = ADDR(.castle_grounds_segment_7); _castle_grounds_segment_7SegmentRomStart = __romPos; .castle_grounds_segment_7 0x07000000 : AT(__romPos) { KEEP(build/us_n64/levels/castle_grounds/leveldata.szp.o(.data*)); . = ALIGN(0x10); } _castle_grounds_segment_7SegmentEnd = ADDR(.castle_grounds_segment_7) + SIZEOF(.castle_grounds_segment_7); _castle_grounds_segment_7SegmentRomEnd = __romPos + SIZEOF(.castle_grounds_segment_7); __romPos += SIZEOF(.castle_grounds_segment_7); _castle_groundsSegmentStart = ADDR(.castle_grounds); _castle_groundsSegmentRomStart = __romPos; .castle_grounds 0x19000000 : AT(__romPos) { KEEP(build/us_n64/levels/castle_grounds/script.o(.data*)); KEEP(build/us_n64/levels/castle_grounds/script.o(.text*)); KEEP(build/us_n64/levels/castle_grounds/script.o(.rodata*)); KEEP(build/us_n64/levels/castle_grounds/geo.o(.data*)); KEEP(build/us_n64/levels/castle_grounds/geo.o(.text*)); KEEP(build/us_n64/levels/castle_grounds/geo.o(.rodata*)); } _castle_groundsSegmentEnd = ADDR(.castle_grounds) + SIZEOF(.castle_grounds); _castle_groundsSegmentRomEnd = __romPos + SIZEOF(.castle_grounds); __romPos += SIZEOF(.castle_grounds); _castle_groundsSegmentBssStart = ADDR(.castle_grounds.noload); .castle_grounds.noload (NOLOAD) : { KEEP(build/us_n64/levels/castle_grounds/script.o(.bss*)); KEEP(build/us_n64/levels/castle_grounds/geo.o(.bss*)); } _castle_groundsSegmentBssEnd = ADDR(.castle_grounds.noload) + SIZEOF(.castle_grounds.noload); _castle_groundsSegmentBssSize = SIZEOF(.castle_grounds.noload);
_bitdw_segment_7SegmentStart = ADDR(.bitdw_segment_7); _bitdw_segment_7SegmentRomStart = __romPos; .bitdw_segment_7 0x07000000 : AT(__romPos) { KEEP(build/us_n64/levels/bitdw/leveldata.szp.o(.data*)); . = ALIGN(0x10); } _bitdw_segment_7SegmentEnd = ADDR(.bitdw_segment_7) + SIZEOF(.bitdw_segment_7); _bitdw_segment_7SegmentRomEnd = __romPos + SIZEOF(.bitdw_segment_7); __romPos += SIZEOF(.bitdw_segment_7); _bitdwSegmentStart = ADDR(.bitdw); _bitdwSegmentRomStart = __romPos; .bitdw 0x19000000 : AT(__romPos) { KEEP(build/us_n64/levels/bitdw/script.o(.data*)); KEEP(build/us_n64/levels/bitdw/script.o(.text*)); KEEP(build/us_n64/levels/bitdw/script.o(.rodata*)); KEEP(build/us_n64/levels/bitdw/geo.o(.data*)); KEEP(build/us_n64/levels/bitdw/geo.o(.text*)); KEEP(build/us_n64/levels/bitdw/geo.o(.rodata*)); } _bitdwSegmentEnd = ADDR(.bitdw) + SIZEOF(.bitdw); _bitdwSegmentRomEnd = __romPos + SIZEOF(.bitdw); __romPos += SIZEOF(.bitdw); _bitdwSegmentBssStart = ADDR(.bitdw.noload); .bitdw.noload (NOLOAD) : { KEEP(build/us_n64/levels/bitdw/script.o(.bss*)); KEEP(build/us_n64/levels/bitdw/geo.o(.bss*)); } _bitdwSegmentBssEnd = ADDR(.bitdw.noload) + SIZEOF(.bitdw.noload); _bitdwSegmentBssSize = SIZEOF(.bitdw.noload);
_vcutm_segment_7SegmentStart = ADDR(.vcutm_segment_7); _vcutm_segment_7SegmentRomStart = __romPos; .vcutm_segment_7 0x07000000 : AT(__romPos) { KEEP(build/us_n64/levels/vcutm/leveldata.szp.o(.data*)); . = ALIGN(0x10); } _vcutm_segment_7SegmentEnd = ADDR(.vcutm_segment_7) + SIZEOF(.vcutm_segment_7); _vcutm_segment_7SegmentRomEnd = __romPos + SIZEOF(.vcutm_segment_7); __romPos += SIZEOF(.vcutm_segment_7); _vcutmSegmentStart = ADDR(.vcutm); _vcutmSegmentRomStart = __romPos; .vcutm 0x19000000 : AT(__romPos) { KEEP(build/us_n64/levels/vcutm/script.o(.data*)); KEEP(build/us_n64/levels/vcutm/script.o(.text*)); KEEP(build/us_n64/levels/vcutm/script.o(.rodata*)); KEEP(build/us_n64/levels/vcutm/geo.o(.data*)); KEEP(build/us_n64/levels/vcutm/geo.o(.text*)); KEEP(build/us_n64/levels/vcutm/geo.o(.rodata*)); } _vcutmSegmentEnd = ADDR(.vcutm) + SIZEOF(.vcutm); _vcutmSegmentRomEnd = __romPos + SIZEOF(.vcutm); __romPos += SIZEOF(.vcutm); _vcutmSegmentBssStart = ADDR(.vcutm.noload); .vcutm.noload (NOLOAD) : { KEEP(build/us_n64/levels/vcutm/script.o(.bss*)); KEEP(build/us_n64/levels/vcutm/geo.o(.bss*)); } _vcutmSegmentBssEnd = ADDR(.vcutm.noload) + SIZEOF(.vcutm.noload); _vcutmSegmentBssSize = SIZEOF(.vcutm.noload);
_bitfs_segment_7SegmentStart = ADDR(.bitfs_segment_7); _bitfs_segment_7SegmentRomStart = __romPos; .bitfs_segment_7 0x07000000 : AT(__romPos) { KEEP(build/us_n64/levels/bitfs/leveldata.szp.o(.data*)); . = ALIGN(0x10); } _bitfs_segment_7SegmentEnd = ADDR(.bitfs_segment_7) + SIZEOF(.bitfs_segment_7); _bitfs_segment_7SegmentRomEnd = __romPos + SIZEOF(.bitfs_segment_7); __romPos += SIZEOF(.bitfs_segment_7); _bitfsSegmentStart = ADDR(.bitfs); _bitfsSegmentRomStart = __romPos; .bitfs 0x19000000 : AT(__romPos) { KEEP(build/us_n64/levels/bitfs/script.o(.data*)); KEEP(build/us_n64/levels/bitfs/script.o(.text*)); KEEP(build/us_n64/levels/bitfs/script.o(.rodata*)); KEEP(build/us_n64/levels/bitfs/geo.o(.data*)); KEEP(build/us_n64/levels/bitfs/geo.o(.text*)); KEEP(build/us_n64/levels/bitfs/geo.o(.rodata*)); } _bitfsSegmentEnd = ADDR(.bitfs) + SIZEOF(.bitfs); _bitfsSegmentRomEnd = __romPos + SIZEOF(.bitfs); __romPos += SIZEOF(.bitfs); _bitfsSegmentBssStart = ADDR(.bitfs.noload); .bitfs.noload (NOLOAD) : { KEEP(build/us_n64/levels/bitfs/script.o(.bss*)); KEEP(build/us_n64/levels/bitfs/geo.o(.bss*)); } _bitfsSegmentBssEnd = ADDR(.bitfs.noload) + SIZEOF(.bitfs.noload); _bitfsSegmentBssSize = SIZEOF(.bitfs.noload);
_sa_segment_7SegmentStart = ADDR(.sa_segment_7); _sa_segment_7SegmentRomStart = __romPos; .sa_segment_7 0x07000000 : AT(__romPos) { KEEP(build/us_n64/levels/sa/leveldata.szp.o(.data*)); . = ALIGN(0x10); } _sa_segment_7SegmentEnd = ADDR(.sa_segment_7) + SIZEOF(.sa_segment_7); _sa_segment_7SegmentRomEnd = __romPos + SIZEOF(.sa_segment_7); __romPos += SIZEOF(.sa_segment_7); _saSegmentStart = ADDR(.sa); _saSegmentRomStart = __romPos; .sa 0x19000000 : AT(__romPos) { KEEP(build/us_n64/levels/sa/script.o(.data*)); KEEP(build/us_n64/levels/sa/script.o(.text*)); KEEP(build/us_n64/levels/sa/script.o(.rodata*)); KEEP(build/us_n64/levels/sa/geo.o(.data*)); KEEP(build/us_n64/levels/sa/geo.o(.text*)); KEEP(build/us_n64/levels/sa/geo.o(.rodata*)); } _saSegmentEnd = ADDR(.sa) + SIZEOF(.sa); _saSegmentRomEnd = __romPos + SIZEOF(.sa); __romPos += SIZEOF(.sa); _saSegmentBssStart = ADDR(.sa.noload); .sa.noload (NOLOAD) : { KEEP(build/us_n64/levels/sa/script.o(.bss*)); KEEP(build/us_n64/levels/sa/geo.o(.bss*)); } _saSegmentBssEnd = ADDR(.sa.noload) + SIZEOF(.sa.noload); _saSegmentBssSize = SIZEOF(.sa.noload);
_bits_segment_7SegmentStart = ADDR(.bits_segment_7); _bits_segment_7SegmentRomStart = __romPos; .bits_segment_7 0x07000000 : AT(__romPos) { KEEP(build/us_n64/levels/bits/leveldata.szp.o(.data*)); . = ALIGN(0x10); } _bits_segment_7SegmentEnd = ADDR(.bits_segment_7) + SIZEOF(.bits_segment_7); _bits_segment_7SegmentRomEnd = __romPos + SIZEOF(.bits_segment_7); __romPos += SIZEOF(.bits_segment_7); _bitsSegmentStart = ADDR(.bits); _bitsSegmentRomStart = __romPos; .bits 0x19000000 : AT(__romPos) { KEEP(build/us_n64/levels/bits/script.o(.data*)); KEEP(build/us_n64/levels/bits/script.o(.text*)); KEEP(build/us_n64/levels/bits/script.o(.rodata*)); KEEP(build/us_n64/levels/bits/geo.o(.data*)); KEEP(build/us_n64/levels/bits/geo.o(.text*)); KEEP(build/us_n64/levels/bits/geo.o(.rodata*)); } _bitsSegmentEnd = ADDR(.bits) + SIZEOF(.bits); _bitsSegmentRomEnd = __romPos + SIZEOF(.bits); __romPos += SIZEOF(.bits); _bitsSegmentBssStart = ADDR(.bits.noload); .bits.noload (NOLOAD) : { KEEP(build/us_n64/levels/bits/script.o(.bss*)); KEEP(build/us_n64/levels/bits/geo.o(.bss*)); } _bitsSegmentBssEnd = ADDR(.bits.noload) + SIZEOF(.bits.noload); _bitsSegmentBssSize = SIZEOF(.bits.noload);
_lll_segment_7SegmentStart = ADDR(.lll_segment_7); _lll_segment_7SegmentRomStart = __romPos; .lll_segment_7 0x07000000 : AT(__romPos) { KEEP(build/us_n64/levels/lll/leveldata.szp.o(.data*)); . = ALIGN(0x10); } _lll_segment_7SegmentEnd = ADDR(.lll_segment_7) + SIZEOF(.lll_segment_7); _lll_segment_7SegmentRomEnd = __romPos + SIZEOF(.lll_segment_7); __romPos += SIZEOF(.lll_segment_7); _lllSegmentStart = ADDR(.lll); _lllSegmentRomStart = __romPos; .lll 0x19000000 : AT(__romPos) { KEEP(build/us_n64/levels/lll/script.o(.data*)); KEEP(build/us_n64/levels/lll/script.o(.text*)); KEEP(build/us_n64/levels/lll/script.o(.rodata*)); KEEP(build/us_n64/levels/lll/geo.o(.data*)); KEEP(build/us_n64/levels/lll/geo.o(.text*)); KEEP(build/us_n64/levels/lll/geo.o(.rodata*)); } _lllSegmentEnd = ADDR(.lll) + SIZEOF(.lll); _lllSegmentRomEnd = __romPos + SIZEOF(.lll); __romPos += SIZEOF(.lll); _lllSegmentBssStart = ADDR(.lll.noload); .lll.noload (NOLOAD) : { KEEP(build/us_n64/levels/lll/script.o(.bss*)); KEEP(build/us_n64/levels/lll/geo.o(.bss*)); } _lllSegmentBssEnd = ADDR(.lll.noload) + SIZEOF(.lll.noload); _lllSegmentBssSize = SIZEOF(.lll.noload);
_ddd_segment_7SegmentStart = ADDR(.ddd_segment_7); _ddd_segment_7SegmentRomStart = __romPos; .ddd_segment_7 0x07000000 : AT(__romPos) { KEEP(build/us_n64/levels/ddd/leveldata.szp.o(.data*)); . = ALIGN(0x10); } _ddd_segment_7SegmentEnd = ADDR(.ddd_segment_7) + SIZEOF(.ddd_segment_7); _ddd_segment_7SegmentRomEnd = __romPos + SIZEOF(.ddd_segment_7); __romPos += SIZEOF(.ddd_segment_7); _dddSegmentStart = ADDR(.ddd); _dddSegmentRomStart = __romPos; .ddd 0x19000000 : AT(__romPos) { KEEP(build/us_n64/levels/ddd/script.o(.data*)); KEEP(build/us_n64/levels/ddd/script.o(.text*)); KEEP(build/us_n64/levels/ddd/script.o(.rodata*)); KEEP(build/us_n64/levels/ddd/geo.o(.data*)); KEEP(build/us_n64/levels/ddd/geo.o(.text*)); KEEP(build/us_n64/levels/ddd/geo.o(.rodata*)); } _dddSegmentEnd = ADDR(.ddd) + SIZEOF(.ddd); _dddSegmentRomEnd = __romPos + SIZEOF(.ddd); __romPos += SIZEOF(.ddd); _dddSegmentBssStart = ADDR(.ddd.noload); .ddd.noload (NOLOAD) : { KEEP(build/us_n64/levels/ddd/script.o(.bss*)); KEEP(build/us_n64/levels/ddd/geo.o(.bss*)); } _dddSegmentBssEnd = ADDR(.ddd.noload) + SIZEOF(.ddd.noload); _dddSegmentBssSize = SIZEOF(.ddd.noload);
_wf_segment_7SegmentStart = ADDR(.wf_segment_7); _wf_segment_7SegmentRomStart = __romPos; .wf_segment_7 0x07000000 : AT(__romPos) { KEEP(build/us_n64/levels/wf/leveldata.szp.o(.data*)); . = ALIGN(0x10); } _wf_segment_7SegmentEnd = ADDR(.wf_segment_7) + SIZEOF(.wf_segment_7); _wf_segment_7SegmentRomEnd = __romPos + SIZEOF(.wf_segment_7); __romPos += SIZEOF(.wf_segment_7); _wfSegmentStart = ADDR(.wf); _wfSegmentRomStart = __romPos; .wf 0x19000000 : AT(__romPos) { KEEP(build/us_n64/levels/wf/script.o(.data*)); KEEP(build/us_n64/levels/wf/script.o(.text*)); KEEP(build/us_n64/levels/wf/script.o(.rodata*)); KEEP(build/us_n64/levels/wf/geo.o(.data*)); KEEP(build/us_n64/levels/wf/geo.o(.text*)); KEEP(build/us_n64/levels/wf/geo.o(.rodata*)); } _wfSegmentEnd = ADDR(.wf) + SIZEOF(.wf); _wfSegmentRomEnd = __romPos + SIZEOF(.wf); __romPos += SIZEOF(.wf); _wfSegmentBssStart = ADDR(.wf.noload); .wf.noload (NOLOAD) : { KEEP(build/us_n64/levels/wf/script.o(.bss*)); KEEP(build/us_n64/levels/wf/geo.o(.bss*)); } _wfSegmentBssEnd = ADDR(.wf.noload) + SIZEOF(.wf.noload); _wfSegmentBssSize = SIZEOF(.wf.noload);
_ending_segment_7SegmentStart = ADDR(.ending_segment_7); _ending_segment_7SegmentRomStart = __romPos; .ending_segment_7 0x07000000 : AT(__romPos) { KEEP(build/us_n64/levels/ending/leveldata.szp.o(.data*)); . = ALIGN(0x10); } _ending_segment_7SegmentEnd = ADDR(.ending_segment_7) + SIZEOF(.ending_segment_7); _ending_segment_7SegmentRomEnd = __romPos + SIZEOF(.ending_segment_7); __romPos += SIZEOF(.ending_segment_7); _endingSegmentStart = ADDR(.ending); _endingSegmentRomStart = __romPos; .ending 0x19000000 : AT(__romPos) { KEEP(build/us_n64/levels/ending/script.o(.data*)); KEEP(build/us_n64/levels/ending/script.o(.text*)); KEEP(build/us_n64/levels/ending/script.o(.rodata*)); KEEP(build/us_n64/levels/ending/geo.o(.data*)); KEEP(build/us_n64/levels/ending/geo.o(.text*)); KEEP(build/us_n64/levels/ending/geo.o(.rodata*)); } _endingSegmentEnd = ADDR(.ending) + SIZEOF(.ending); _endingSegmentRomEnd = __romPos + SIZEOF(.ending); __romPos += SIZEOF(.ending); _endingSegmentBssStart = ADDR(.ending.noload); .ending.noload (NOLOAD) : { KEEP(build/us_n64/levels/ending/script.o(.bss*)); KEEP(build/us_n64/levels/ending/geo.o(.bss*)); } _endingSegmentBssEnd = ADDR(.ending.noload) + SIZEOF(.ending.noload); _endingSegmentBssSize = SIZEOF(.ending.noload);
_castle_courtyard_segment_7SegmentStart = ADDR(.castle_courtyard_segment_7); _castle_courtyard_segment_7SegmentRomStart = __romPos; .castle_courtyard_segment_7 0x07000000 : AT(__romPos) { KEEP(build/us_n64/levels/castle_courtyard/leveldata.szp.o(.data*)); . = ALIGN(0x10); } _castle_courtyard_segment_7SegmentEnd = ADDR(.castle_courtyard_segment_7) + SIZEOF(.castle_courtyard_segment_7); _castle_courtyard_segment_7SegmentRomEnd = __romPos + SIZEOF(.castle_courtyard_segment_7); __romPos += SIZEOF(.castle_courtyard_segment_7); _castle_courtyardSegmentStart = ADDR(.castle_courtyard); _castle_courtyardSegmentRomStart = __romPos; .castle_courtyard 0x19000000 : AT(__romPos) { KEEP(build/us_n64/levels/castle_courtyard/script.o(.data*)); KEEP(build/us_n64/levels/castle_courtyard/script.o(.text*)); KEEP(build/us_n64/levels/castle_courtyard/script.o(.rodata*)); KEEP(build/us_n64/levels/castle_courtyard/geo.o(.data*)); KEEP(build/us_n64/levels/castle_courtyard/geo.o(.text*)); KEEP(build/us_n64/levels/castle_courtyard/geo.o(.rodata*)); } _castle_courtyardSegmentEnd = ADDR(.castle_courtyard) + SIZEOF(.castle_courtyard); _castle_courtyardSegmentRomEnd = __romPos + SIZEOF(.castle_courtyard); __romPos += SIZEOF(.castle_courtyard); _castle_courtyardSegmentBssStart = ADDR(.castle_courtyard.noload); .castle_courtyard.noload (NOLOAD) : { KEEP(build/us_n64/levels/castle_courtyard/script.o(.bss*)); KEEP(build/us_n64/levels/castle_courtyard/geo.o(.bss*)); } _castle_courtyardSegmentBssEnd = ADDR(.castle_courtyard.noload) + SIZEOF(.castle_courtyard.noload); _castle_courtyardSegmentBssSize = SIZEOF(.castle_courtyard.noload);
_pss_segment_7SegmentStart = ADDR(.pss_segment_7); _pss_segment_7SegmentRomStart = __romPos; .pss_segment_7 0x07000000 : AT(__romPos) { KEEP(build/us_n64/levels/pss/leveldata.szp.o(.data*)); . = ALIGN(0x10); } _pss_segment_7SegmentEnd = ADDR(.pss_segment_7) + SIZEOF(.pss_segment_7); _pss_segment_7SegmentRomEnd = __romPos + SIZEOF(.pss_segment_7); __romPos += SIZEOF(.pss_segment_7); _pssSegmentStart = ADDR(.pss); _pssSegmentRomStart = __romPos; .pss 0x19000000 : AT(__romPos) { KEEP(build/us_n64/levels/pss/script.o(.data*)); KEEP(build/us_n64/levels/pss/script.o(.text*)); KEEP(build/us_n64/levels/pss/script.o(.rodata*)); KEEP(build/us_n64/levels/pss/geo.o(.data*)); KEEP(build/us_n64/levels/pss/geo.o(.text*)); KEEP(build/us_n64/levels/pss/geo.o(.rodata*)); } _pssSegmentEnd = ADDR(.pss) + SIZEOF(.pss); _pssSegmentRomEnd = __romPos + SIZEOF(.pss); __romPos += SIZEOF(.pss); _pssSegmentBssStart = ADDR(.pss.noload); .pss.noload (NOLOAD) : { KEEP(build/us_n64/levels/pss/script.o(.bss*)); KEEP(build/us_n64/levels/pss/geo.o(.bss*)); } _pssSegmentBssEnd = ADDR(.pss.noload) + SIZEOF(.pss.noload); _pssSegmentBssSize = SIZEOF(.pss.noload);
_cotmc_segment_7SegmentStart = ADDR(.cotmc_segment_7); _cotmc_segment_7SegmentRomStart = __romPos; .cotmc_segment_7 0x07000000 : AT(__romPos) { KEEP(build/us_n64/levels/cotmc/leveldata.szp.o(.data*)); . = ALIGN(0x10); } _cotmc_segment_7SegmentEnd = ADDR(.cotmc_segment_7) + SIZEOF(.cotmc_segment_7); _cotmc_segment_7SegmentRomEnd = __romPos + SIZEOF(.cotmc_segment_7); __romPos += SIZEOF(.cotmc_segment_7); _cotmcSegmentStart = ADDR(.cotmc); _cotmcSegmentRomStart = __romPos; .cotmc 0x19000000 : AT(__romPos) { KEEP(build/us_n64/levels/cotmc/script.o(.data*)); KEEP(build/us_n64/levels/cotmc/script.o(.text*)); KEEP(build/us_n64/levels/cotmc/script.o(.rodata*)); KEEP(build/us_n64/levels/cotmc/geo.o(.data*)); KEEP(build/us_n64/levels/cotmc/geo.o(.text*)); KEEP(build/us_n64/levels/cotmc/geo.o(.rodata*)); } _cotmcSegmentEnd = ADDR(.cotmc) + SIZEOF(.cotmc); _cotmcSegmentRomEnd = __romPos + SIZEOF(.cotmc); __romPos += SIZEOF(.cotmc); _cotmcSegmentBssStart = ADDR(.cotmc.noload); .cotmc.noload (NOLOAD) : { KEEP(build/us_n64/levels/cotmc/script.o(.bss*)); KEEP(build/us_n64/levels/cotmc/geo.o(.bss*)); } _cotmcSegmentBssEnd = ADDR(.cotmc.noload) + SIZEOF(.cotmc.noload); _cotmcSegmentBssSize = SIZEOF(.cotmc.noload);
_totwc_segment_7SegmentStart = ADDR(.totwc_segment_7); _totwc_segment_7SegmentRomStart = __romPos; .totwc_segment_7 0x07000000 : AT(__romPos) { KEEP(build/us_n64/levels/totwc/leveldata.szp.o(.data*)); . = ALIGN(0x10); } _totwc_segment_7SegmentEnd = ADDR(.totwc_segment_7) + SIZEOF(.totwc_segment_7); _totwc_segment_7SegmentRomEnd = __romPos + SIZEOF(.totwc_segment_7); __romPos += SIZEOF(.totwc_segment_7); _totwcSegmentStart = ADDR(.totwc); _totwcSegmentRomStart = __romPos; .totwc 0x19000000 : AT(__romPos) { KEEP(build/us_n64/levels/totwc/script.o(.data*)); KEEP(build/us_n64/levels/totwc/script.o(.text*)); KEEP(build/us_n64/levels/totwc/script.o(.rodata*)); KEEP(build/us_n64/levels/totwc/geo.o(.data*)); KEEP(build/us_n64/levels/totwc/geo.o(.text*)); KEEP(build/us_n64/levels/totwc/geo.o(.rodata*)); } _totwcSegmentEnd = ADDR(.totwc) + SIZEOF(.totwc); _totwcSegmentRomEnd = __romPos + SIZEOF(.totwc); __romPos += SIZEOF(.totwc); _totwcSegmentBssStart = ADDR(.totwc.noload); .totwc.noload (NOLOAD) : { KEEP(build/us_n64/levels/totwc/script.o(.bss*)); KEEP(build/us_n64/levels/totwc/geo.o(.bss*)); } _totwcSegmentBssEnd = ADDR(.totwc.noload) + SIZEOF(.totwc.noload); _totwcSegmentBssSize = SIZEOF(.totwc.noload);
_bowser_1_segment_7SegmentStart = ADDR(.bowser_1_segment_7); _bowser_1_segment_7SegmentRomStart = __romPos; .bowser_1_segment_7 0x07000000 : AT(__romPos) { KEEP(build/us_n64/levels/bowser_1/leveldata.szp.o(.data*)); . = ALIGN(0x10); } _bowser_1_segment_7SegmentEnd = ADDR(.bowser_1_segment_7) + SIZEOF(.bowser_1_segment_7); _bowser_1_segment_7SegmentRomEnd = __romPos + SIZEOF(.bowser_1_segment_7); __romPos += SIZEOF(.bowser_1_segment_7); _bowser_1SegmentStart = ADDR(.bowser_1); _bowser_1SegmentRomStart = __romPos; .bowser_1 0x19000000 : AT(__romPos) { KEEP(build/us_n64/levels/bowser_1/script.o(.data*)); KEEP(build/us_n64/levels/bowser_1/script.o(.text*)); KEEP(build/us_n64/levels/bowser_1/script.o(.rodata*)); KEEP(build/us_n64/levels/bowser_1/geo.o(.data*)); KEEP(build/us_n64/levels/bowser_1/geo.o(.text*)); KEEP(build/us_n64/levels/bowser_1/geo.o(.rodata*)); } _bowser_1SegmentEnd = ADDR(.bowser_1) + SIZEOF(.bowser_1); _bowser_1SegmentRomEnd = __romPos + SIZEOF(.bowser_1); __romPos += SIZEOF(.bowser_1); _bowser_1SegmentBssStart = ADDR(.bowser_1.noload); .bowser_1.noload (NOLOAD) : { KEEP(build/us_n64/levels/bowser_1/script.o(.bss*)); KEEP(build/us_n64/levels/bowser_1/geo.o(.bss*)); } _bowser_1SegmentBssEnd = ADDR(.bowser_1.noload) + SIZEOF(.bowser_1.noload); _bowser_1SegmentBssSize = SIZEOF(.bowser_1.noload);
_wmotr_segment_7SegmentStart = ADDR(.wmotr_segment_7); _wmotr_segment_7SegmentRomStart = __romPos; .wmotr_segment_7 0x07000000 : AT(__romPos) { KEEP(build/us_n64/levels/wmotr/leveldata.szp.o(.data*)); . = ALIGN(0x10); } _wmotr_segment_7SegmentEnd = ADDR(.wmotr_segment_7) + SIZEOF(.wmotr_segment_7); _wmotr_segment_7SegmentRomEnd = __romPos + SIZEOF(.wmotr_segment_7); __romPos += SIZEOF(.wmotr_segment_7); _wmotrSegmentStart = ADDR(.wmotr); _wmotrSegmentRomStart = __romPos; .wmotr 0x19000000 : AT(__romPos) { KEEP(build/us_n64/levels/wmotr/script.o(.data*)); KEEP(build/us_n64/levels/wmotr/script.o(.text*)); KEEP(build/us_n64/levels/wmotr/script.o(.rodata*)); KEEP(build/us_n64/levels/wmotr/geo.o(.data*)); KEEP(build/us_n64/levels/wmotr/geo.o(.text*)); KEEP(build/us_n64/levels/wmotr/geo.o(.rodata*)); } _wmotrSegmentEnd = ADDR(.wmotr) + SIZEOF(.wmotr); _wmotrSegmentRomEnd = __romPos + SIZEOF(.wmotr); __romPos += SIZEOF(.wmotr); _wmotrSegmentBssStart = ADDR(.wmotr.noload); .wmotr.noload (NOLOAD) : { KEEP(build/us_n64/levels/wmotr/script.o(.bss*)); KEEP(build/us_n64/levels/wmotr/geo.o(.bss*)); } _wmotrSegmentBssEnd = ADDR(.wmotr.noload) + SIZEOF(.wmotr.noload); _wmotrSegmentBssSize = SIZEOF(.wmotr.noload);

_bowser_2_segment_7SegmentStart = ADDR(.bowser_2_segment_7); _bowser_2_segment_7SegmentRomStart = __romPos; .bowser_2_segment_7 0x07000000 : AT(__romPos) { KEEP(build/us_n64/levels/bowser_2/leveldata.szp.o(.data*)); . = ALIGN(0x10); } _bowser_2_segment_7SegmentEnd = ADDR(.bowser_2_segment_7) + SIZEOF(.bowser_2_segment_7); _bowser_2_segment_7SegmentRomEnd = __romPos + SIZEOF(.bowser_2_segment_7); __romPos += SIZEOF(.bowser_2_segment_7); _bowser_2SegmentStart = ADDR(.bowser_2); _bowser_2SegmentRomStart = __romPos; .bowser_2 0x19000000 : AT(__romPos) { KEEP(build/us_n64/levels/bowser_2/script.o(.data*)); KEEP(build/us_n64/levels/bowser_2/script.o(.text*)); KEEP(build/us_n64/levels/bowser_2/script.o(.rodata*)); KEEP(build/us_n64/levels/bowser_2/geo.o(.data*)); KEEP(build/us_n64/levels/bowser_2/geo.o(.text*)); KEEP(build/us_n64/levels/bowser_2/geo.o(.rodata*)); } _bowser_2SegmentEnd = ADDR(.bowser_2) + SIZEOF(.bowser_2); _bowser_2SegmentRomEnd = __romPos + SIZEOF(.bowser_2); __romPos += SIZEOF(.bowser_2); _bowser_2SegmentBssStart = ADDR(.bowser_2.noload); .bowser_2.noload (NOLOAD) : { KEEP(build/us_n64/levels/bowser_2/script.o(.bss*)); KEEP(build/us_n64/levels/bowser_2/geo.o(.bss*)); } _bowser_2SegmentBssEnd = ADDR(.bowser_2.noload) + SIZEOF(.bowser_2.noload); _bowser_2SegmentBssSize = SIZEOF(.bowser_2.noload);
_bowser_3_segment_7SegmentStart = ADDR(.bowser_3_segment_7); _bowser_3_segment_7SegmentRomStart = __romPos; .bowser_3_segment_7 0x07000000 : AT(__romPos) { KEEP(build/us_n64/levels/bowser_3/leveldata.szp.o(.data*)); . = ALIGN(0x10); } _bowser_3_segment_7SegmentEnd = ADDR(.bowser_3_segment_7) + SIZEOF(.bowser_3_segment_7); _bowser_3_segment_7SegmentRomEnd = __romPos + SIZEOF(.bowser_3_segment_7); __romPos += SIZEOF(.bowser_3_segment_7); _bowser_3SegmentStart = ADDR(.bowser_3); _bowser_3SegmentRomStart = __romPos; .bowser_3 0x19000000 : AT(__romPos) { KEEP(build/us_n64/levels/bowser_3/script.o(.data*)); KEEP(build/us_n64/levels/bowser_3/script.o(.text*)); KEEP(build/us_n64/levels/bowser_3/script.o(.rodata*)); KEEP(build/us_n64/levels/bowser_3/geo.o(.data*)); KEEP(build/us_n64/levels/bowser_3/geo.o(.text*)); KEEP(build/us_n64/levels/bowser_3/geo.o(.rodata*)); } _bowser_3SegmentEnd = ADDR(.bowser_3) + SIZEOF(.bowser_3); _bowser_3SegmentRomEnd = __romPos + SIZEOF(.bowser_3); __romPos += SIZEOF(.bowser_3); _bowser_3SegmentBssStart = ADDR(.bowser_3.noload); .bowser_3.noload (NOLOAD) : { KEEP(build/us_n64/levels/bowser_3/script.o(.bss*)); KEEP(build/us_n64/levels/bowser_3/geo.o(.bss*)); } _bowser_3SegmentBssEnd = ADDR(.bowser_3.noload) + SIZEOF(.bowser_3.noload); _bowser_3SegmentBssSize = SIZEOF(.bowser_3.noload);

_ttm_segment_7SegmentStart = ADDR(.ttm_segment_7); _ttm_segment_7SegmentRomStart = __romPos; .ttm_segment_7 0x07000000 : AT(__romPos) { KEEP(build/us_n64/levels/ttm/leveldata.szp.o(.data*)); . = ALIGN(0x10); } _ttm_segment_7SegmentEnd = ADDR(.ttm_segment_7) + SIZEOF(.ttm_segment_7); _ttm_segment_7SegmentRomEnd = __romPos + SIZEOF(.ttm_segment_7); __romPos += SIZEOF(.ttm_segment_7); _ttmSegmentStart = ADDR(.ttm); _ttmSegmentRomStart = __romPos; .ttm 0x19000000 : AT(__romPos) { KEEP(build/us_n64/levels/ttm/script.o(.data*)); KEEP(build/us_n64/levels/ttm/script.o(.text*)); KEEP(build/us_n64/levels/ttm/script.o(.rodata*)); KEEP(build/us_n64/levels/ttm/geo.o(.data*)); KEEP(build/us_n64/levels/ttm/geo.o(.text*)); KEEP(build/us_n64/levels/ttm/geo.o(.rodata*)); } _ttmSegmentEnd = ADDR(.ttm) + SIZEOF(.ttm); _ttmSegmentRomEnd = __romPos + SIZEOF(.ttm); __romPos += SIZEOF(.ttm); _ttmSegmentBssStart = ADDR(.ttm.noload); .ttm.noload (NOLOAD) : { KEEP(build/us_n64/levels/ttm/script.o(.bss*)); KEEP(build/us_n64/levels/ttm/geo.o(.bss*)); } _ttmSegmentBssEnd = ADDR(.ttm.noload) + SIZEOF(.ttm.noload); _ttmSegmentBssSize = SIZEOF(.ttm.noload);


   _assetsSegmentStart = ADDR(.assets); _assetsSegmentRomStart = __romPos; .assets __romPos : AT(__romPos)
   {
      KEEP(build/us_n64/assets/mario_anim_data.o(.data*));
      KEEP(build/us_n64/assets/mario_anim_data.o(.rodata*));
      KEEP(build/us_n64/assets/demo_data.o(.data*));
      KEEP(build/us_n64/sound/sound_data.o(.data*));
   }
   _assetsSegmentEnd = ADDR(.assets) + SIZEOF(.assets); _assetsSegmentRomEnd = __romPos + SIZEOF(.assets); __romPos += SIZEOF(.assets);
   _mapDataSegmentStart = ADDR(.mapData); _mapDataSegmentRomStart = __romPos; .mapData ((0x80000000 + (0x00100000 * 8)) - 0x00100000) : AT(__romPos) {
      KEEP(build/us_n64/asm/debug/map.o(.data*));
   }
   _mapDataSegmentEnd = ADDR(.mapData) + SIZEOF(.mapData); _mapDataSegmentRomEnd = __romPos + SIZEOF(.mapData); __romPos += SIZEOF(.mapData);
   .debug 0 : { *(.debug) }
   .line 0 : { *(.line) }
   .debug_srcinfo 0 : { *(.debug_srcinfo) }
   .debug_sfnames 0 : { *(.debug_sfnames) }
   .debug_aranges 0 : { *(.debug_aranges) }
   .debug_pubnames 0 : { *(.debug_pubnames) }
   .debug_info 0 : { *(.debug_info .gnu.linkonce.wi.*) }
   .debug_abbrev 0 : { *(.debug_abbrev) }
   .debug_line 0 : { *(.debug_line .debug_line.* .debug_line_end ) }
   .debug_frame 0 : { *(.debug_frame) }
   .debug_str 0 : { *(.debug_str) }
   .debug_loc 0 : { *(.debug_loc) }
   .debug_macinfo 0 : { *(.debug_macinfo) }
   .debug_weaknames 0 : { *(.debug_weaknames) }
   .debug_funcnames 0 : { *(.debug_funcnames) }
   .debug_typenames 0 : { *(.debug_typenames) }
   .debug_varnames 0 : { *(.debug_varnames) }
   .debug_pubtypes 0 : { *(.debug_pubtypes) }
   .debug_ranges 0 : { *(.debug_ranges) }
   .debug_macro 0 : { *(.debug_macro) }
   .gnu.attributes 0 : { KEEP (*(.gnu.attributes)) }
   /DISCARD/ :
   {
      *(*);
   }
}
